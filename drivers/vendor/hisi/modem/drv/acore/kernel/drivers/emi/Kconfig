## drivers/vendor/hisi/modem/drv/acore/kernel/drivers/emi/Kconfig
```kconfig
#
# Balong EMI  configuration
#

comment "balong emi driver"

config EMI_SUPPORT
	tristate "support emi"
	select FB_2_4_INCH_BALONG
	help
	  EMI driver
	  
```

## drivers/vendor/hisi/modem/drv/acore/kernel/drivers/modem/balong_oam_ps/Kconfig
```kconfig
#
# acore image load
#

comment "lmsp lps gumsp gups acore image"

config BALONG_OAM_PS
	tristate "support lmsp lps gumsp gups"
	default n
	help
	  lmsp lps gumsp gups acore image
```

## drivers/vendor/hisi/modem/drv/acore/kernel/drivers/modem/efuse/Kconfig
```kconfig
#
# EFUSE infrastructure and drivers
#

config EFUSE_BALONG
	tristate "Hisi Balong EFUSE Read/Write support"
	help
	  Support for the Hisi balongv7r2 SoC Read or write.
```

## drivers/vendor/hisi/modem/drv/acore/kernel/drivers/modem/hkadc/Kconfig
```kconfig
#
# hkadc
#

comment "hkadc driver"

config HKADC_BALONG
	tristate "hkadc driver"
	default n
	help
	  hkadc driver
```

## drivers/vendor/hisi/modem/drv/acore/kernel/drivers/modem/keyboard/Kconfig
```kconfig
#
# Keyboard configuration
#

config BALONG_KEYBOARD_GPIO
	tristate "Balong GPIO Buttons"
	depends on ARCH_HI6930 && GPIO_BALONG
	help
	  Balong gpio_key for DCM E5
```

## drivers/vendor/hisi/modem/drv/acore/kernel/drivers/modem/reset_hifi/Kconfig
```kconfig
#
# hifi reset driver
#

comment "hifi  reset"

config HIFI_RESET
	tristate "support hifi reset feature"
	default n
	help
	 hifi reset
```

## drivers/vendor/hisi/modem/drv/acore/kernel/drivers/modem/temperature/Kconfig
```kconfig
#
# TEMPERATURE SYS infrastructure and drivers
#

config TEMPERATURE_SYS_BALONG
	tristate "Hisi Balong Temperature Sys support"
	help
	  Support for the Hisi balongv7r2 SoC Temperature Sys.
	  
```

## drivers/vendor/hisi/modem/drv/acore/kernel/drivers/pmic/Kconfig
```kconfig
menuconfig PMIC
	bool "Voltage and Current Support"
	help
	  Generic Voltage and Current support.

	  This framework is designed to provide a generic interface to voltage
	  and current regulators within the Linux kernel. It's intended to
	  provide voltage and current control to client or consumer drivers and
	  also provide status information to user space applications through a
	  sysfs interface.

	  The intention is to allow systems to dynamically control regulator
	  output in order to save power and prolong battery life. This applies
	  to both voltage regulators (where voltage output is controllable) and
	  current sinks (where current output is controllable).

	  This framework safely compiles out if not selected so that client
	  drivers can still be used in systems with no software controllable
	  regulators.

	  If unsure, say no.

if PMIC

config POWER_PMIC_HI6451
	tristate "National Semiconductors HI6451 PMIC driver"
	depends on SPI
	help
	 Say Y here to support the voltage regulators and convertors
	 on National Semiconductors HI6451 PMIC
     
config POWER_PMIC_HI6551
	tristate "National Semiconductors HI6551 PMIC driver"
	help
	 Say Y here to support the voltage regulators and convertors
	 on National Semiconductors HI6551 PMIC
          
config POWER_PMIC_HI6559
	tristate "National Semiconductors HI6559 PMIC driver"
	help
	 Say Y here to support the voltage regulators and convertors
	 on National Semiconductors HI6559 PMIC
     
config HI6551_COUL
 	tristate "National Semiconductors HI6551 COUL driver"
	depends on POWER_PMIC_HI6551
	help
	 Say Y here to support the voltage and current decetion
	 on National Semiconductors HI6551 PMIC  
     
config POWER_PMIC_DEBUG
	tristate "National Semiconductors PMIC_DEBUG driver"
	help
	 Say Y here to support the debug on National Semiconductors PMIC Moudle
config POWER_PMIC_TEST
	tristate "National Semiconductors PMIC_TEST driver"
	help
	 Say Y here to support the debug on National Semiconductors PMIC Moudle

endif
```

## drivers/vendor/hisi/modem/drv/acore/kernel/drivers/pwm/Kconfig
```kconfig
menuconfig PWM
	bool "Pulse Width Modulation Support"
	help
	  Pulse Width Modulation support.

	  This framework is designed to provide a generic interface to voltage
	  and current regulators within the Linux kernel. It's intended to
	  provide voltage and current control to client or consumer drivers and
	  also provide status information to user space applications through a
	  sysfs interface.

	  The intention is to allow systems to dynamically control regulator
	  output in order to save power and prolong battery life. This applies
	  to both voltage regulators (where voltage output is controllable) and
	  current sinks (where current output is controllable).

	  This framework safely compiles out if not selected so that client
	  drivers can still be used in systems with no software controllable
	  regulators.

	  If unsure, say no.

if PWM

config PWM_BALONG
	tristate "National Semiconductors PWM driver"
	help
	 Say Y here to support the voltage regulators and convertors
	 on National Semiconductors PWM IC
          
config LEDS_PWM_BALONG
	tristate "National Semiconductors PMIC_DEBUG driver"
    depends on PWM_BALONG
	help
	 Say Y here to support the debug on National Semiconductors LEDS_PWM Moudle

endif
```

## drivers/vendor/hisi/modem/drv/acore/kernel/drivers/slave/Kconfig
```kconfig
#
# ARASAN SDIO card drivers
#

comment "ARASAN SDIO Card Drivers"

config SDIO_ARASAN
	tristate "ARASAN SDIO Card driver"
	default n
	help
	  Say Y here to enable the RASAN SDIO Card driver support.
	  Almost everyone wishing RASAN SDIO Card support
	  should say Y or M here.

config SDIO_ARASAN_DEBUG
	bool "ARASAN SDIO Card debugging"
```

## drivers/vendor/hisi/modem/drv/acore/kernel/drivers/usb/dwc3/Kconfig
```kconfig
config USB_DWC3
	tristate "DesignWare USB3 DRD Core Support"
	depends on (USB && USB_GADGET)
	select USB_OTG_UTILS
	select USB_GADGET_DUALSPEED
	select USB_GADGET_SUPERSPEED
	select USB_XHCI_PLATFORM if USB_SUPPORT && USB_XHCI_HCD
	help
	  Say Y or M here if your system has a Dual Role SuperSpeed
	  USB controller based on the DesignWare USB3 IP Core.

	  If you choose to build this driver is a dynamically linked
	  module, the module will be called dwc3.ko.

if USB_DWC3
config GADGET_SUPPORT_REMOTE_WAKEUP
	bool "Support the remote wakeup"
	help
	  Say Y here to support remote gadget remote wakeup.

config USB_DWC3_DEBUG
	bool "Enable Debugging Messages"
	help
	  Say Y here to enable debugging messages on DWC3 Driver.

config USB_DWC3_VERBOSE
	bool "Enable Verbose Debugging Messages"
	depends on USB_DWC3_DEBUG
	help
	  Say Y here to enable verbose debugging messages on DWC3 Driver.

config DWC3_INTERRUPT_GATHER
	bool "dwc3 interrupt gather"
	help
		select it if you'd like to reduce the interrupt pressure.

config DWC3_DBG
	bool "dwc3 dbg(balong) system"
	help
		select it if you'd like to use dwc3 dbg system.

config USB_DWC3_FORCE_HOST
	bool "Force host mode"
	---help---
	  Say 'Y' to force dwc3 to host mode.
	  
config USB_DWC3_FORCE_DEVICE
	bool "Force device mode"
	---help---
	  Say 'Y' to force dwc3 to device mode.
endif
```

## drivers/vendor/hisi/modem/drv/acore/kernel/drivers/usb/susb/Kconfig
```kconfig
menuconfig USB_DWC
        tristate "USB DWC Support susb"

if USB_DWC
config USB_GADGET_SNPS_DWC_OTG
        tristate "Synopsys Driver for DWC_otg Controller"
        depends on USB && EXPERIMENTAL
#        select USB_OTG
        select USB_GADGET_DUALSPEED
        help
           Selects the Synopsys Driver for the DWC_otg Controller.

config USB_DWC_OTG_LPM
        tristate "Enable LPM support"
        depends on USB && EXPERIMENTAL
        help
           Enables LPM support.
endif
```

## drivers/vendor/hisi/modem/drv/acore/kernel/net/nat-sa/Kconfig
```kconfig
menu "nat speed acceleration"
	depends on NET && INET && NETFILTER && NF_CONNTRACK

config NAT_SA
	tristate "nat speed acceleration module"
	help
	  If this option is enabled, the kernel will include support
	  for soft nat speedup.

if NAT_SA
config NAT_SA_DEBUG
	bool "debug info for nat sa module"
	help
	  Enable to check the debug info. Strongly suggested to disable 
	  when compiled an release version

config NAT_SA_REL_TRACE
	bool "debug info in release version"
	help
	  Eanble to check the state info in release version. Suggested 
          to enable this macro. It could be disabled if you insist.
	
endif #if NAT_SOFT_SPEEDUP

endmenu
```
