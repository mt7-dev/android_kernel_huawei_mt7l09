; System Settings

	SYStem.CPU CORTEXa9MPCORE
	
	SYStem.Option DACR ON          ; give Debugger global write permissions
	
 ; add hardware specific options here
	TrOnchip.Set DABORT OFF        ; used by Linux for page miss!
	TrOnchip.Set PABORT OFF        ; used by Linux for page miss!
	TrOnchip.Set UNDEF OFF         ; may be used by Linux for FPU detection
	SYStem.Option MMUSPACES ON     ; enable space ids to virtual addresses

	SYStem.CONFIG ETMBASE 0x80036000
    	system.config tpiubase 0x80032000
	SYStem.Up

; Load the target code
	;Data.LOAD D:\balong_modem.elf

if (&has_load_modem_elf==0)
(
	if OS.FILE(&exc_dir\balong_modem.elf)
	(
		Data.LOAD &exc_dir\balong_modem.elf /nocode
		&has_load_modem_elf=1
	)
	else
	(
		d.load.auto *.elf
		&has_load_modem_elf=1
	)
)
	
	;d.load D:\etb\vmlinux  /nocode
	;y.spath.SETRECURSEDIR Z:\disk3\jiangguang\k3v3-4.4\kernel\

; ETM Settings
	ETM.PortSize 32.
	ETM.ContextID On
	ETM.TRACEID 3.     ;need modify it by the trace target
	ETM.PortMode  Wrapped
	ETM.DataTrace OFF
    ETM.ON

	
; Import trace data
;	LA.Mode FLOWTRACE ON
	;LA.IMPORT.ETB D:\etb_24.bin
if OS.FILE(&exc_dir\etb.bin)
(
	LA.IMPORT.ETB &exc_dir\etb.bin
)
else
(
	dialog.ok "please slect etb.bin"
	LA.IMPORT.ETB *.bin
)
	la.list tp tpc flen list.exec run address symbol cycle data list.code list.asm
	
	print "EOF"
	ENDDO
	
	