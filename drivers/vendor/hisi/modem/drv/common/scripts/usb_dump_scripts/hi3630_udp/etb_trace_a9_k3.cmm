; System Settings
	SYStem.CPU CORTEXa9MPCORE	
	SYStem.Option DACR ON          ; give Debugger global write permissions
	
 ; add hardware specific options here
	TrOnchip.Set DABORT OFF        ; used by Linux for page miss!
	TrOnchip.Set PABORT OFF        ; used by Linux for page miss!
	TrOnchip.Set UNDEF OFF         ; may be used by Linux for FPU detection
	SYStem.Option MMUSPACES ON     ; enable space ids to virtual addresses
	SYStem.CONFIG ETMBASE 0x80036000
	SYStem.Up

; Load the target code
	d.load.auto *.elf

; ETM Settings
	ETM.PortSize 32.
	ETM.ContextID On
	ETM.TRACEID 3.     ;need modify it by the trace target
	ETM.PortMode  Wrapped
	ETM.DataTrace OFF
    ETM.ON
	
; Import trace data
	LA.IMPORT.ETB *.bin
	la.list tp tpc flen list.exec run address symbol cycle data list.code list.asm
	
	print "EOF"
	ENDDO
	
	