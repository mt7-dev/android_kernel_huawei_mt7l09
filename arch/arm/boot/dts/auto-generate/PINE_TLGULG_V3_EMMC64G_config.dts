/*
 * Hisilicon Ltd.
 *
 * A15x4 A7x4
 *
 * It is only a demo for hisilicon hi3630 board. You show change the
 * address of each node according to datasheet.
 */

/dts-v1/;


/include/ "PINE_TLGULG_V1_config.dtsi"
/include/ "hisi_3630_pin_PINE_TLGULG_V3_EMMC64G.dtsi"
/include/ "hisi_3630_modem_PINE_TLGULG_V3_EMMC64G.dtsi"
/ {
	board_info: board_info {
		hisi,boardid = <3 2 7>;
		hisi,boardname = "Pine_TLGULG_V3_EMMC64G";
		hisi,config_profile = "high";
		hw,public;
	};
};
