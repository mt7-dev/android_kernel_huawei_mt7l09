/*
 * Hisilicon Ltd.
 *
 * A15x4 A7x4
 *
 * It is only a demo for hisilicon hi3630 board. You show change the
 * address of each node according to datasheet.
 */

/dts-v1/;

/include/ "fastboot.dtsi"
/include/ "JAZZ_CLG_V3_config.dtsi"
/include/ "JAZZ_CLG_VN1_pin.dtsi"
/include/ "JAZZ_CLG_VN1_modem_pin.dtsi"

/ {
	hisi,boardid = <9 5 2 7>;
	hisi,boardname = "JAZZ_CLG_VN1";
	board_info: board_info {
		hw,public;
	};

	anc_headset: anc_headset@0{
		anc_hs_limit_min = <5>;
		anc_hs_limit_max = <200>;
		status = "ok";
	};
};
