/* DO NOT EDIT - Automatically generated by python */
/ {
		guangyu_3500_22k:guangyu_3500_22k {
			fcc = <3500>;
			default_rbatt_mohm = <100>;
			id_identify_min = <460>;
			id_identify_max = <756>;
			id_voltage_min = <581>;
			id_voltage_max = <642>;
			vbat_max = <4352>;
			temp_para = 
						"-32767","0","-1","0","4100","0",
						"0","10","-1","1050","4352","3",
						"10","45","-1","-1","4352","3",
						"45","50","-1","820","4352","3",
						"50","32767","-1","0","4352","0";
			vbat_para = 
						"-32767","3400","-1","820","0",
						"3400","32767","-1","-1","0";
			segment_para = 
						"-32767","4150","3500","4208","50",
						"4150","4450","1750","4352","0";
			batt_brand = "guangyu";
			fcc_temp = <3552 3556 3556 3584 3566 3550>;
			fcc_sf_x = <0 100 200 300 400 500>;
			fcc_sf_y = <100 96 94 92 90 88>;
			fcc_sf_cols = <6>;
			pc_sf_rows = <1>;
			pc_sf_cols = <1>;
			pc_sf_row_entries = <0>;
			pc_sf_percent = <100>;
			pc_sf_sf = <100>;
			rbatt_sf_rows = <28>;
			rbatt_sf_cols = <6>;
			rbatt_sf_percent = <100 95 90 85 80 75 70 65 60 55 50 45 40 35 30 25 20 15 10 9 8 7 6 5 4 3 2 1>;
			rbatt_sf_sf = <
			               1818 753 394 139 114 106
			               1817 753 394 139 114 107
			               1741 756 397 139 114 107
			               1650 755 404 140 115 107
			               1620 767 414 144 118 108
			               1443 769 452 152 122 109
			               1395 665 395 153 122 111
			               1392 673 388 169 129 115
			               1380 673 377 164 135 120
			               1389 671 365 137 117 109
			               1428 679 367 132 113 107
			               1475 711 375 133 114 107
			               1528 763 388 135 115 109
			               1587 820 417 138 119 111
			               1650 885 453 138 118 112
			               1722 960 495 135 112 107
			               1808 1050 544 135 113 106
			               1928 1196 603 136 113 106
			               2117 1008 490 136 115 106
			               2269 1063 489 136 115 108
			               2447 1135 511 138 115 109
			               2618 1226 534 138 115 110
			               2825 1335 581 138 116 110
			               3040 1457 626 138 114 108
			               3280 1585 658 140 115 109
			               3585 1742 700 147 117 110
			               4006 1979 790 240 120 109
			               4721 2391 1004 197 186 114
			              >;
			pc_temp_ocv_rows = <29>;
			pc_temp_ocv_cols = <6>;
			pc_temp_ocv_percent = <100 95 90 85 80 75 70 65 60 55 50 45 40 35 30 25 20 15 10 9 8 7 6 5 4 3 2 1>;
			pc_temp_ocv_ocv = <
			                   4329 4328 4325 4323 4317 4312
			                   4239 4251 4253 4260 4255 4252
			                   4176 4195 4197 4204 4199 4196
			                   4118 4143 4146 4150 4145 4142
			                   4078 4097 4099 4099 4094 4091
			                   3987 4044 4053 4055 4048 4043
			                   3934 3958 3973 3991 3994 3999
			                   3898 3921 3932 3959 3960 3958
			                   3863 3886 3896 3916 3918 3917
			                   3836 3854 3860 3870 3870 3869
			                   3820 3826 3832 3841 3840 3839
			                   3806 3808 3811 3818 3818 3817
			                   3793 3795 3794 3801 3800 3798
			                   3780 3784 3784 3786 3785 3783
			                   3766 3773 3775 3772 3769 3765
			                   3752 3759 3763 3756 3747 3736
			                   3738 3739 3745 3737 3728 3716
			                   3721 3718 3719 3712 3703 3692
			                   3698 3696 3694 3690 3682 3671
			                   3691 3692 3691 3688 3681 3670
			                   3683 3687 3688 3686 3679 3668
			                   3672 3682 3683 3683 3676 3665
			                   3657 3673 3676 3674 3669 3656
			                   3636 3656 3659 3650 3647 3633
			                   3603 3625 3626 3609 3607 3594
			                   3557 3576 3575 3555 3556 3543
			                   3491 3508 3507 3489 3488 3475
			                   3393 3411 3410 3383 3392 3376
			                   3200 3200 3200 3200 3200 3200
			                  >;
		};
};
