/*
 * Hisilicon Ltd.
 *
 * A15x4 A7x4
 *
 * It is only a demo for hisilicon hi3630 board. You show change the
 * address of each node according to datasheet.
 */



/include/ "MOGOLIA_ULG_V3_noNFC_config.dtsi"
/include/ "hisi_3630_pin_MOGOLIA_ULCA_GENERAL_V3_noNFC.dtsi"
/include/ "hisi_3630_modem_MOGOLIA_ULCA_GENERAL_V3_noNFC.dtsi"
/ {
	board_info: board_info {
		hisi,boardid = <2 2 7>;
		hisi,boardname = "Mogolia_ULCA_GENERAL_V3_noNFC";
		hisi,modem_id = <0x3fb0e000>;
		hw,public;
	};
};
