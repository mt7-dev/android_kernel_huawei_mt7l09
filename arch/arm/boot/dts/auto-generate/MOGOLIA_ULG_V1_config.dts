/*
 * Hisilicon Ltd.
 *
 * A15x4 A7x4
 *
 * It is only a demo for hisilicon hi3630 board. You show change the
 * address of each node according to datasheet.
 */

/dts-v1/;


/include/ "MOGOLIA_TL_V1_config.dtsi"
/include/ "hisi_3630_pin_MOGOLIA_ULG_V1.dtsi"
/include/ "hisi_3630_modem_MOGOLIA_ULG_V1.dtsi"
/ {
	board_info: board_info {
		hisi,boardid = <2 0 7>;
		hisi,boardname = "Mogolia_UL+G_V1";
		hisi,modem_id = <0x3fb51000>;
		hw,public;
	};
	audio_hal_config {
		aud_para = "MOGOLIA_ULG";
	};

	bcm_wifi {
		wifi_nvram_name = "nvram4334_hw_mogolia_ulg.txt";
		wifi_fw_name = "fw_bcm4334_hw.bin";
		status = "ok";
	};

};
