/include/ "hisi_3630fpga_clock.dtsi"
/include/ "hisi_3630fpga_gpio.dtsi"
/include/ "hisi_k3v3_hi6421v300.dtsi"
/ {
  vpp{
        compatible = "hisilicon,k3vpp";
       	reg = <0xE8968000 0x1FFF>;
		interrupts = <0 141 4>;
		//clock
		clocks = <&clk_gate_vpp>;
		clock-names = "clk_vpp";	
        //these are for ldo resources
        ldo_vpp-supply = <&vppip>;
        status = "disabled";
    };
};

