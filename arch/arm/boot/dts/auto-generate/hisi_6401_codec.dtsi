/*
 *  Copyright (C) 2013 Hisilicon Ltd.
 *
 *  This program is free software; you can redistribute it and/or modify
 *  it under the terms of the GNU General Public License version 2 as
 *  publishhed by the Free Software Foundation.
 */

/ {
	hi6401_irq: hi6401_irq@e82b9000 {
		compatible = "hisilicon,hi6401-irq";
		reg = <0xe82b9000 0x800>; /* 0x200 << 2 */
		#interrupt-cells = <2>;
		interrupt-controller;
		status = "disable";

		hi6401_codec: hi6401_codec@0{
			compatible = "hisilicon,hi6401-codec";
			interrupt-parent = <&hi6401_irq>;
			interrupts = <7 0>, <6 0>, <5 0>, <4 0>, <3 0>, <2 0>, <1 0>, <0 0>;
			interrupt-names = "otp", "saradc", "plugout", "plugin",
					  "btndown_eco", "btnup_eco", "btndown", "btnup";
			status = "disable";
		}; /* end of codec */
	};
};
