/*
 *  Copyright (C) 2013 Hisilicon Ltd.
 *
 *  This program is free software; you can redistribute it and/or modify
 *  it under the terms of the GNU General Public License version 2 as
 *  publishhed by the Free Software Foundation.
 */

/ {
	hisi_6421_spk: hisi_6421_spk@fff34000 {
		compatible = "hisilicon,hisi-6421-spk";
		reg = <0xfff34000 0x1000>;
		status = "disable";
	};
};
