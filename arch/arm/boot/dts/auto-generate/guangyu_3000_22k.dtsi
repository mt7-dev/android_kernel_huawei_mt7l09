/* DO NOT EDIT - Automatically generated by python */
/ {
		guangyu_3000_22k:guangyu_3000_22k {
			fcc = <3000>;
			default_rbatt_mohm = <100>;
			id_identify_min = <460>;
			id_identify_max = <756>;
			id_voltage_min = <581>;
			id_voltage_max = <642>;
			vbat_max = <4352>;
			temp_para = 
						"-32767","0","-1","0","4100","0",
						"0","10","-1","900","4352","3",
						"10","45","-1","-1","4352","3",
						"45","50","-1","820","4352","3",
						"50","32767","-1","0","4352","0";
			vbat_para = 
						"-32767","3400","-1","820","0",
						"3400","32767","-1","-1","0";
			segment_para = 
						"-32767","4150","3000","4208","50",
						"4150","4450","1500","4352","0";
			batt_brand = "guangyu";
			fcc_temp = <3013 3014 3016 3031 3031 3009>;
			fcc_sf_x = <0 100 200 300 400 500>;
			fcc_sf_y = <100 96 94 92 90 88>;
			fcc_sf_cols = <6>;
			pc_sf_rows = <1>;
			pc_sf_cols = <1>;
			pc_sf_row_entries = <0>;
			pc_sf_percent = <100>;
			pc_sf_sf = <100>;
			rbatt_sf_rows = <28>;
			rbatt_sf_cols = <6>;
			rbatt_sf_percent = <100 95 90 85 80 75 70 65 60 55 50 45 40 35 30 25 20 15 10 9 8 7 6 5 4 3 2 1>;
			rbatt_sf_sf = <
			               2296 1218 555 154 124 116
			               2295 1218 555 154 124 116
			               2157 1236 570 155 125 116
			               2015 1213 583 159 127 118
			               1974 1232 604 164 130 119
			               1760 1140 645 180 140 121
			               1717 1075 529 180 138 124
			               1715 1101 533 202 149 131
			               1704 1108 532 184 149 133
			               1699 1122 537 153 126 118
			               1762 1161 547 151 124 117
			               1829 1236 555 153 126 118
			               1900 1319 601 158 129 120
			               1981 1414 659 162 134 123
			               2069 1514 725 162 132 119
			               2169 1620 792 159 125 117
			               2287 1768 875 158 125 117
			               2447 1942 988 161 126 118
			               2777 1853 1035 163 129 120
			               3036 1627 929 163 128 120
			               3289 1766 978 160 129 118
			               3533 1910 1057 163 128 120
			               3803 2045 1140 162 127 121
			               4109 2198 1212 160 126 119
			               4433 2395 1256 164 129 119
			               4864 2650 1353 170 130 120
			               5383 2992 1559 182 131 122
			               6090 3480 1878 216 139 127
			              >;
			pc_temp_ocv_rows = <29>;
			pc_temp_ocv_cols = <6>;
			pc_temp_ocv_percent = <100 95 90 85 80 75 70 65 60 55 50 45 40 35 30 25 20 15 10 9 8 7 6 5 4 3 2 1>;
			pc_temp_ocv_ocv = <
			                   4331 4329 4327 4324 4318 4313
			                   4236 4244 4252 4261 4258 4254
			                   4170 4184 4194 4205 4202 4199
			                   4109 4124 4141 4152 4148 4145
			                   4068 4079 4093 4099 4096 4094
			                   3976 4004 4048 4060 4052 4045
			                   3925 3941 3963 3991 3995 4001
			                   3887 3905 3922 3958 3960 3960
			                   3850 3868 3886 3913 3913 3913
			                   3816 3835 3852 3868 3868 3868
			                   3798 3810 3825 3840 3839 3839
			                   3784 3796 3801 3818 3817 3817
			                   3771 3783 3788 3800 3799 3798
			                   3759 3773 3777 3784 3784 3783
			                   3748 3759 3767 3769 3767 3761
			                   3736 3741 3752 3754 3746 3735
			                   3722 3725 3732 3734 3726 3715
			                   3705 3710 3706 3708 3701 3689
			                   3678 3692 3689 3688 3681 3671
			                   3669 3686 3685 3687 3680 3669
			                   3659 3679 3680 3685 3678 3667
			                   3645 3671 3673 3681 3675 3664
			                   3628 3656 3661 3672 3666 3653
			                   3607 3634 3640 3645 3640 3626
			                   3576 3602 3605 3601 3598 3585
			                   3535 3556 3553 3546 3545 3533
			                   3477 3492 3484 3474 3475 3465
			                   3388 3395 3385 3370 3375 3367
			                   3200 3200 3200 3200 3200 3200
			                  >;
		};
};
