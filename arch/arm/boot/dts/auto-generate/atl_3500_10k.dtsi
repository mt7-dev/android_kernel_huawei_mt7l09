/* DO NOT EDIT - Automatically generated by python */
/ {
		atl_3500_10k:atl_3500_10k {
			fcc = <3500>;
			default_rbatt_mohm = <100>;
			id_identify_min = <0>;
			id_identify_max = <460>;
			id_voltage_min = <303>;
			id_voltage_max = <339>;
			vbat_max = <4352>;
			temp_para = 
						"-32767","0","-1","0","4100","0",
						"0","10","-1","1050","4352","3",
						"10","45","-1","-1","4352","3",
						"45","50","-1","820","4352","3",
						"50","32767","-1","0","4352","0";
			vbat_para = 
						"-32767","3400","-1","820","0",
						"3400","32767","-1","-1","0";
			segment_para = 
						"-32767","4150","3500","4208","50",
						"4150","4450","1750","4352","0";
			batt_brand = "atl";
			fcc_temp = <3583 3587 3581 3636 3587 3572>;
			fcc_sf_x = <0 100 200 300 400 500>;
			fcc_sf_y = <100 96 94 92 90 88>;
			fcc_sf_cols = <6>;
			pc_sf_rows = <1>;
			pc_sf_cols = <1>;
			pc_sf_row_entries = <0>;
			pc_sf_percent = <100>;
			pc_sf_sf = <100>;
			rbatt_sf_rows = <28>;
			rbatt_sf_cols = <6>;
			rbatt_sf_percent = <100 95 90 85 80 75 70 65 60 55 50 45 40 35 30 25 20 15 10 9 8 7 6 5 4 3 2 1>;
			rbatt_sf_sf = <
			               1689 710 398 142 110 97
			               1686 710 398 142 110 97
			               1567 726 409 146 111 99
			               1463 727 420 150 114 101
			               1438 729 429 157 117 102
			               1339 715 441 167 121 104
			               1323 660 414 177 126 108
			               1323 655 402 188 135 112
			               1319 649 389 175 145 119
			               1336 648 378 146 129 117
			               1388 654 375 140 111 100
			               1455 690 376 142 112 100
			               1538 754 385 144 115 103
			               1637 829 415 146 118 106
			               1751 920 461 147 118 106
			               1889 1026 524 147 113 98
			               2063 1168 604 147 111 98
			               2304 1381 714 148 112 99
			               4047 1630 678 146 113 101
			               4518 1817 729 148 115 102
			               4974 2037 784 152 116 103
			               5527 2281 888 157 117 104
			               6126 2591 1028 166 120 104
			               6817 2948 1196 173 122 105
			               7595 3330 1392 171 122 104
			               8534 3821 1629 186 123 105
			               9862 4511 1987 392 127 109
			               13656 5696 2716 228 239 113
			              >;
			pc_temp_ocv_rows = <29>;
			pc_temp_ocv_cols = <6>;
			pc_temp_ocv_percent = <100 95 90 85 80 75 70 65 60 55 50 45 40 35 30 25 20 15 10 9 8 7 6 5 4 3 2 1>;
			pc_temp_ocv_ocv = <
			                   4329 4328 4323 4329 4312 4308
			                   4231 4244 4247 4261 4249 4245
			                   4158 4181 4187 4203 4191 4189
			                   4091 4125 4131 4147 4136 4134
			                   4042 4072 4079 4094 4084 4082
			                   3969 4016 4026 4044 4036 4034
			                   3921 3954 3970 3997 3992 3990
			                   3881 3912 3926 3955 3953 3951
			                   3844 3874 3886 3910 3914 3913
			                   3816 3841 3851 3866 3869 3870
			                   3800 3813 3823 3836 3833 3833
			                   3786 3796 3801 3813 3811 3810
			                   3773 3785 3785 3794 3793 3792
			                   3759 3774 3776 3779 3778 3777
			                   3746 3760 3767 3766 3765 3761
			                   3731 3743 3755 3754 3749 3738
			                   3716 3722 3735 3737 3730 3717
			                   3696 3702 3705 3707 3699 3689
			                   3669 3679 3675 3680 3673 3662
			                   3662 3673 3671 3678 3671 3660
			                   3651 3668 3666 3674 3668 3658
			                   3640 3660 3661 3670 3665 3654
			                   3625 3651 3654 3664 3659 3649
			                   3606 3637 3642 3649 3646 3636
			                   3578 3610 3617 3615 3615 3602
			                   3536 3567 3573 3561 3563 3550
			                   3480 3500 3504 3499 3491 3480
			                   3389 3405 3410 3389 3395 3378
			                   3200 3200 3200 3200 3200 3200
			                  >;
		};
};
