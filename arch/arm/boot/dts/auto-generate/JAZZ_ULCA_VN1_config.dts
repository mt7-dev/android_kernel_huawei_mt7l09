/*
 * Hisilicon Ltd.
 *
 * A15x4 A7x4
 *
 * It is only a demo for hisilicon hi3630 board. You show change the
 * address of each node according to datasheet.
 */

/dts-v1/;


/include/ "JAZZ_ULCA_V3_config.dtsi"
/include/ "hisi_3630_pin_JAZZ_ULCA_VN1.dtsi"
/include/ "hisi_3630_modem_JAZZ_ULCA_VN1.dtsi"
/ {
	board_info: board_info {
		hisi,boardid = <7 2 7>;
		hisi,boardname = "Jazz_UL+CA_VN1";
		hw,public;
	};

	anc_headset: anc_headset@0{
		anc_hs_limit_min = <5>;
		anc_hs_limit_max = <200>;
		status = "ok";
	};
};
