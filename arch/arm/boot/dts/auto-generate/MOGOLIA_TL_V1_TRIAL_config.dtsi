/*
 * Hisilicon Ltd.
 *
 * A15x4 A7x4
 *
 * It is only a demo for hisilicon hi3630 board. You show change the
 * address of each node according to datasheet.
 */



/include/ "MOGOLIA_TL_V1_config.dtsi"
/include/ "hisi_3630_pin_MOGOLIA_TL_V1_TRIAL.dtsi"
/include/ "hisi_3630_modem_MOGOLIA_TL_V1_TRIAL.dtsi"
/ {
	board_info: board_info {
		hisi,boardid = <7 0 0>;
		hisi,boardname = "Mogolia_TL_V1_TRIAL";
		hw,public;
	};
};
