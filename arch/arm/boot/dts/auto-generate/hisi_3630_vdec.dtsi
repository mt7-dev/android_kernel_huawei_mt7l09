/* Copyright (c) 2012, Code Aurora Forum. All rights reserved.
 *
 * This program is free software; you can redistribute it and/or modify
 * it under the terms of the GNU General Public License version 2 and
 * only version 2 as published by the Free Software Foundation.
 *
 * This program is distributed in the hope that it will be useful,
 * but WITHOUT ANY WARRANTY; without even the implied warranty of
 * MERCHANTABILITY or FITNESS FOR A PARTICULAR PURPOSE.  See the
 * GNU General Public License for more details.
 */
/include/ "hisi_3630_clock.dtsi"
/include/ "hisi_3630_gpio.dtsi"
/include/ "hisi_6421v300_pmu.dtsi"
/ {
	vdec@E8910000{
	 compatible = "hisi,k3v3-vdec";
        reg = <0xe8910000 0x10000>;
        interrupts = <0 144 4>; 
        clocks = <&clk_gate_vdec>;
        clock-names = "clk_vdec";
        ldo_vdec-supply = <&vdec>;
        status = "disabled";
	};
};
