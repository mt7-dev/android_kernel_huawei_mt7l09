/*
 * Hisilicon Ltd.
 *
 * A15x4 A7x4
 *
 * It is only a demo for hisilicon hi3630 board. You show change the
 * address of each node according to datasheet.
 */


/include/ "JAZZ_ULCA_VN1_config.dtsi"

/ {
	hisi,boardid = <9 4 4 7>;
	hisi,boardname = "JAZZ_ULCA_JAPAN";
	board_info: board_info {
		hisi,modem_id = <0x3fb08400>;
		hw,public;
	};
};
