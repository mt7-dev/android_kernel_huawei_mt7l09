/* DO NOT EDIT - Automatically generated by python */
/ {
		guangyu_4000_22k:guangyu_4000_22k {
			fcc = <4000>;
			default_rbatt_mohm = <100>;
			id_identify_min = <460>;
			id_identify_max = <756>;
			id_voltage_min = <581>;
			id_voltage_max = <642>;
			vbat_max = <4352>;
			temp_para = 
						"-32767","0","-1","0","4100","0",
						"0","10","-1","1200","4352","3",
						"10","45","-1","-1","4352","3",
						"45","50","-1","820","4352","3",
						"50","32767","-1","0","4352","0";
			vbat_para = 
						"-32767","3400","-1","820","0",
						"3400","32767","-1","-1","0";
			segment_para = 
						"-32767","4150","4000","4208","50",
						"4150","4450","2000","4352","0";
			batt_brand = "guangyu";
			fcc_temp = <4106 4109 4110 4129 4127 4100>;
			fcc_sf_x = <0 100 200 300 400 500>;
			fcc_sf_y = <100 96 94 92 90 88>;
			fcc_sf_cols = <6>;
			pc_sf_rows = <1>;
			pc_sf_cols = <1>;
			pc_sf_row_entries = <0>;
			pc_sf_percent = <100>;
			pc_sf_sf = <100>;
			rbatt_sf_rows = <28>;
			rbatt_sf_cols = <6>;
			rbatt_sf_percent = <100 95 90 85 80 75 70 65 60 55 50 45 40 35 30 25 20 15 10 9 8 7 6 5 4 3 2 1>;
			rbatt_sf_sf = <
			               1565 695 344 128 112 107
			               1563 696 344 128 112 107
			               1495 704 349 129 112 108
			               1420 705 353 132 114 108
			               1398 721 361 135 115 109
			               1251 720 400 144 120 111
			               1216 625 342 147 122 113
			               1213 638 332 159 129 117
			               1210 640 332 145 129 119
			               1231 644 322 127 114 108
			               1266 664 322 126 112 108
			               1312 706 330 128 113 108
			               1366 759 342 131 115 110
			               1424 823 368 133 118 113
			               1486 895 401 132 116 111
			               1563 982 441 130 112 108
			               1665 1103 485 130 113 108
			               1802 1289 545 130 114 108
			               2126 1109 434 129 114 112
			               2290 1208 445 130 115 110
			               2430 1312 474 132 116 110
			               2575 1441 511 132 117 114
			               2729 1575 559 133 117 112
			               2869 1704 602 132 115 110
			               3040 1819 649 133 115 110
			               3325 1917 718 135 117 112
			               3667 2016 797 155 119 114
			               4315 2465 877 342 165 133
			              >;
			pc_temp_ocv_rows = <29>;
			pc_temp_ocv_cols = <6>;
			pc_temp_ocv_percent = <100 95 90 85 80 75 70 65 60 55 50 45 40 35 30 25 20 15 10 9 8 7 6 5 4 3 2 1>;
			pc_temp_ocv_ocv = <
			                   4333 4331 4330 4327 4322 4316
			                   4238 4251 4257 4265 4262 4257
			                   4173 4192 4201 4208 4205 4202
			                   4112 4137 4148 4154 4151 4147
			                   4070 4090 4099 4103 4099 4095
			                   3980 4035 4055 4058 4050 4046
			                   3928 3950 3972 3995 3998 4001
			                   3891 3911 3927 3959 3961 3959
			                   3857 3874 3892 3912 3915 3914
			                   3833 3842 3857 3869 3868 3868
			                   3814 3818 3829 3840 3840 3839
			                   3799 3803 3807 3818 3817 3817
			                   3786 3790 3792 3800 3799 3798
			                   3773 3778 3781 3784 3784 3782
			                   3760 3764 3772 3769 3765 3760
			                   3747 3747 3759 3752 3744 3734
			                   3735 3729 3739 3732 3725 3713
			                   3721 3714 3713 3705 3699 3689
			                   3700 3695 3691 3688 3681 3670
			                   3696 3691 3688 3686 3680 3669
			                   3690 3686 3686 3684 3678 3667
			                   3682 3681 3681 3681 3675 3665
			                   3670 3672 3673 3670 3667 3656
			                   3651 3656 3655 3641 3642 3633
			                   3621 3628 3623 3598 3602 3594
			                   3578 3585 3577 3541 3550 3544
			                   3512 3517 3513 3466 3481 3478
			                   3409 3413 3417 3362 3383 3384
			                   3200 3200 3200 3200 3200 3200
			                  >;
		};
};
