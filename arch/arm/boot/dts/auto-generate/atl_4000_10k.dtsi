/* DO NOT EDIT - Automatically generated by python */
/ {
		atl_4000_10k:atl_4000_10k {
			fcc = <4000>;
			default_rbatt_mohm = <100>;
			id_identify_min = <0>;
			id_identify_max = <460>;
			id_voltage_min = <303>;
			id_voltage_max = <339>;
			vbat_max = <4352>;
			temp_para = 
						"-32767","0","-1","0","4100","0",
						"0","10","-1","1200","4352","3",
						"10","45","-1","-1","4352","3",
						"45","50","-1","820","4352","3",
						"50","32767","-1","0","4352","0";
			vbat_para = 
						"-32767","3400","-1","820","0",
						"3400","32767","-1","-1","0";
			segment_para = 
						"-32767","4150","4000","4208","50",
						"4150","4450","2000","4352","0";
			batt_brand = "atl";
			fcc_temp = <4104 4107 4107 4150 4117 4106>;
			fcc_sf_x = <0 100 200 300 400 500>;
			fcc_sf_y = <100 96 94 92 90 88>;
			fcc_sf_cols = <6>;
			pc_sf_rows = <1>;
			pc_sf_cols = <1>;
			pc_sf_row_entries = <0>;
			pc_sf_percent = <100>;
			pc_sf_sf = <100>;
			rbatt_sf_rows = <28>;
			rbatt_sf_cols = <6>;
			rbatt_sf_percent = <100 95 90 85 80 75 70 65 60 55 50 45 40 35 30 25 20 15 10 9 8 7 6 5 4 3 2 1>;
			rbatt_sf_sf = <
			               1638 779 406 150 124 116
			               1635 780 406 150 124 116
			               1515 790 415 152 124 117
			               1434 791 424 155 127 118
			               1370 791 437 161 129 119
			               1295 741 441 168 131 120
			               1283 732 421 179 137 124
			               1276 722 407 186 145 128
			               1281 709 393 175 152 133
			               1305 718 385 155 136 127
			               1354 746 383 149 125 118
			               1426 798 383 149 126 118
			               1513 870 402 151 128 120
			               1612 957 439 153 131 122
			               1720 1060 495 154 130 122
			               1837 1183 567 153 126 117
			               1986 1320 652 153 125 117
			               2209 1470 771 155 127 118
			               3853 1617 747 153 128 119
			               4241 1726 806 155 128 120
			               4675 1864 894 159 129 121
			               5150 1933 1014 162 131 122
			               5702 2318 1182 166 132 124
			               6282 2789 1350 172 133 123
			               6851 3240 1517 175 133 122
			               7837 3723 1611 182 138 126
			               9114 4367 1702 222 185 176
			               12396 5272 2362 401 262 184
			              >;
			pc_temp_ocv_rows = <29>;
			pc_temp_ocv_cols = <6>;
			pc_temp_ocv_percent = <100 95 90 85 80 75 70 65 60 55 50 45 40 35 30 25 20 15 10 9 8 7 6 5 4 3 2 1>;
			pc_temp_ocv_ocv = <
			                   4324 4323 4321 4323 4312 4308
			                   4218 4233 4241 4255 4247 4244
			                   4144 4167 4179 4197 4189 4187
			                   4083 4109 4124 4142 4134 4132
			                   4021 4056 4073 4090 4083 4080
			                   3953 3990 4020 4041 4035 4032
			                   3908 3943 3968 3996 3991 3989
			                   3870 3899 3922 3953 3952 3949
			                   3840 3858 3880 3907 3912 3911
			                   3819 3827 3846 3865 3866 3867
			                   3805 3808 3817 3835 3833 3832
			                   3794 3796 3797 3811 3811 3809
			                   3782 3786 3785 3793 3793 3791
			                   3771 3774 3776 3778 3778 3776
			                   3758 3760 3766 3766 3763 3758
			                   3742 3743 3751 3753 3746 3736
			                   3725 3726 3728 3734 3727 3715
			                   3708 3709 3698 3702 3697 3686
			                   3689 3687 3670 3678 3671 3661
			                   3683 3682 3666 3676 3669 3659
			                   3676 3678 3662 3673 3667 3657
			                   3669 3664 3659 3668 3663 3653
			                   3661 3653 3655 3661 3658 3648
			                   3643 3639 3647 3644 3644 3634
			                   3600 3613 3626 3608 3611 3599
			                   3545 3567 3581 3551 3558 3547
			                   3476 3500 3504 3475 3491 3482
			                   3375 3398 3408 3370 3396 3383
			                   3200 3200 3200 3200 3200 3200
			                  >;
		};
};
