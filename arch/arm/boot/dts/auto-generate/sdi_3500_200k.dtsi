/* DO NOT EDIT - Automatically generated by python */
/ {
		sdi_3500_200k:sdi_3500_200k {
			fcc = <3500>;
			default_rbatt_mohm = <100>;
			id_identify_min = <1702>;
			id_identify_max = <2022>;
			id_voltage_min = <1797>;
			id_voltage_max = <1934>;
			vbat_max = <4352>;
			temp_para = 
						"-32767","0","-1","0","4100","0",
						"0","10","-1","1050","4352","3",
						"10","45","-1","-1","4352","3",
						"45","50","-1","820","4352","3",
						"50","32767","-1","0","4352","0";
			vbat_para = 
						"-32767","3400","-1","820","0",
						"3400","32767","-1","-1","0";
			segment_para = 
						"-32767","4150","3500","4208","50",
						"4150","4450","1750","4352","0";
			batt_brand = "sdi";
			fcc_temp = <3419 3422 3423 3439 3421 3411>;
			fcc_sf_x = <0 100 200 300 400 500>;
			fcc_sf_y = <100 96 94 92 90 88>;
			fcc_sf_cols = <6>;
			pc_sf_rows = <1>;
			pc_sf_cols = <1>;
			pc_sf_row_entries = <0>;
			pc_sf_percent = <100>;
			pc_sf_sf = <100>;
			rbatt_sf_rows = <28>;
			rbatt_sf_cols = <6>;
			rbatt_sf_percent = <100 95 90 85 80 75 70 65 60 55 50 45 40 35 30 25 20 15 10 9 8 7 6 5 4 3 2 1>;
			rbatt_sf_sf = <
			               2488 1786 1158 207 128 99
			               2488 1786 1158 207 128 99
			               2310 1675 1127 212 130 101
			               2207 1582 1071 218 134 103
			               2086 1537 1075 224 137 106
			               1964 1380 963 242 143 110
			               1932 1339 922 238 150 114
			               1920 1328 910 246 159 119
			               1931 1311 893 215 148 115
			               1959 1313 881 197 129 103
			               1998 1332 895 195 127 102
			               2043 1364 920 201 130 105
			               2102 1406 960 207 135 109
			               2178 1463 1002 210 139 113
			               2277 1539 1051 209 137 107
			               2393 1640 1111 216 132 103
			               2517 1759 1200 222 131 104
			               2659 1898 1328 222 128 102
			               2855 2068 1506 250 137 107
			               2900 2104 1544 258 140 108
			               3681 2338 1475 255 144 110
			               4389 2521 1481 250 146 110
			               5232 2757 1500 249 141 107
			               5601 2978 1582 239 134 104
			               5880 3142 1663 236 132 105
			               6223 3366 1761 242 136 107
			               6619 3622 1885 254 140 109
			               7524 4097 2170 313 175 161
			              >;
			pc_temp_ocv_rows = <29>;
			pc_temp_ocv_cols = <6>;
			pc_temp_ocv_percent = <100 95 90 85 80 75 70 65 60 55 50 45 40 35 30 25 20 15 10 9 8 7 6 5 4 3 2 1>;
			pc_temp_ocv_ocv = <
			                   4323 4319 4317 4304 4301 4297
			                   4224 4229 4235 4240 4242 4240
			                   4153 4168 4177 4186 4190 4188
			                   4103 4115 4120 4136 4139 4137
			                   4038 4073 4082 4087 4089 4088
			                   3964 3986 4005 4045 4046 4042
			                   3917 3937 3953 3987 3998 3999
			                   3877 3900 3914 3952 3960 3959
			                   3847 3864 3877 3905 3914 3914
			                   3824 3834 3844 3867 3872 3873
			                   3804 3811 3820 3838 3844 3844
			                   3785 3791 3801 3817 3821 3822
			                   3766 3773 3786 3798 3802 3802
			                   3749 3758 3770 3782 3785 3785
			                   3734 3744 3753 3766 3768 3762
			                   3720 3733 3738 3752 3749 3738
			                   3701 3722 3724 3733 3728 3715
			                   3675 3706 3711 3704 3698 3686
			                   3638 3675 3693 3688 3681 3668
			                   3630 3668 3688 3686 3680 3667
			                   3619 3659 3682 3684 3679 3666
			                   3606 3648 3674 3681 3676 3663
			                   3588 3631 3661 3674 3670 3654
			                   3570 3610 3642 3654 3653 3631
			                   3542 3580 3614 3616 3616 3590
			                   3506 3540 3570 3560 3564 3537
			                   3454 3482 3506 3484 3495 3465
			                   3378 3397 3412 3367 3395 3359
			                   3200 3200 3200 3200 3200 3200
			                  >;
		};
};
