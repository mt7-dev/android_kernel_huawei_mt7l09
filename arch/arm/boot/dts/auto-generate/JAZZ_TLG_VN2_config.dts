/*
 * Hisilicon Ltd.
 *
 * A15x4 A7x4
 *
 * It is only a demo for hisilicon hi3630 board. You show change the
 * address of each node according to datasheet.
 */

/dts-v1/;

/include/ "fastboot.dtsi"
/include/ "JAZZ_TLG_VN1_config.dtsi"
/include/ "JAZZ_TLG_VN2_pin.dtsi"
/include/ "JAZZ_TLG_VN2_modem_pin.dtsi"

/ {
	hisi,boardid = <9 1 3 7>;
	hisi,boardname = "JAZZ_TLG_VN2";
	board_info: board_info {
		hisi,modem_id = <0x3FF53400>;
		hw,public;
	};
};
