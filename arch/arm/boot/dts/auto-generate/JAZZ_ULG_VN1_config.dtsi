/*
 * Hisilicon Ltd.
 *
 * A15x4 A7x4
 *
 * It is only a demo for hisilicon hi3630 board. You show change the
 * address of each node according to datasheet.
 */



/include/ "JAZZ_ULG_V3_config.dtsi"
/include/ "hisi_3630_pin_JAZZ_ULG_VN1.dtsi"
/include/ "hisi_3630_modem_JAZZ_ULG_VN1.dtsi"
/ {
	board_info: board_info {
		hisi,boardid = <6 2 7>;
		hisi,boardname = "Jazz_UL+G_VN1";
		hw,public;
	};

	anc_headset: anc_headset@0{
		anc_hs_limit_min = <5>;
		anc_hs_limit_max = <200>;
		status = "ok";
	};
};
