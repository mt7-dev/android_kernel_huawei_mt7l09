/* DO NOT EDIT - Automatically generated by python */
/ {
		atl_3000_10k:atl_3000_10k {
			fcc = <3000>;
			default_rbatt_mohm = <100>;
			id_identify_min = <0>;
			id_identify_max = <460>;
			id_voltage_min = <303>;
			id_voltage_max = <339>;
			vbat_max = <4352>;
			temp_para = 
						"-32767","0","-1","0","4100","0",
						"0","10","-1","900","4352","3",
						"10","45","-1","-1","4352","3",
						"45","50","-1","820","4352","3",
						"50","32767","-1","0","4352","0";
			vbat_para = 
						"-32767","3400","-1","820","0",
						"3400","32767","-1","-1","0";
			segment_para = 
						"-32767","4150","3000","4208","50",
						"4150","4450","1500","4352","0";
			batt_brand = "atl";
			fcc_temp = <3033 3034 3032 3050 3044 3024>;
			fcc_sf_x = <0 100 200 300 400 500>;
			fcc_sf_y = <100 96 94 92 90 88>;
			fcc_sf_cols = <6>;
			pc_sf_rows = <1>;
			pc_sf_cols = <1>;
			pc_sf_row_entries = <0>;
			pc_sf_percent = <100>;
			pc_sf_sf = <100>;
			rbatt_sf_rows = <28>;
			rbatt_sf_cols = <6>;
			rbatt_sf_percent = <100 95 90 85 80 75 70 65 60 55 50 45 40 35 30 25 20 15 10 9 8 7 6 5 4 3 2 1>;
			rbatt_sf_sf = <
			               1945 876 456 149 120 111
			               1943 876 456 149 120 111
			               1816 900 469 151 122 113
			               1692 905 486 156 124 114
			               1658 927 498 161 127 115
			               1524 882 528 171 131 118
			               1500 822 482 182 137 121
			               1498 817 464 200 148 127
			               1498 809 443 198 157 135
			               1515 808 434 156 131 118
			               1594 831 429 150 122 114
			               1696 903 419 151 123 115
			               1811 1002 443 155 127 117
			               1934 1124 492 158 133 120
			               2063 1255 565 159 131 121
			               2209 1393 652 156 124 114
			               2391 1560 750 154 122 113
			               2637 1768 870 159 122 113
			               4010 2024 909 160 126 116
			               4629 2200 906 161 126 116
			               5065 2432 973 159 126 115
			               5531 2680 1073 165 127 116
			               6025 2959 1196 169 129 118
			               6587 3266 1333 172 129 117
			               7217 3599 1471 178 129 118
			               7973 3995 1643 184 133 118
			               8932 4540 1942 261 145 125
			               10221 5278 2367 531 224 177
			              >;
			pc_temp_ocv_rows = <29>;
			pc_temp_ocv_cols = <6>;
			pc_temp_ocv_percent = <100 95 90 85 80 75 70 65 60 55 50 45 40 35 30 25 20 15 10 9 8 7 6 5 4 3 2 1>;
			pc_temp_ocv_ocv = <
			                   4328 4327 4324 4319 4313 4307
			                   4226 4240 4248 4255 4250 4246
			                   4157 4179 4188 4197 4193 4190
			                   4091 4122 4134 4142 4138 4135
			                   4042 4074 4083 4090 4086 4084
			                   3967 4013 4036 4042 4038 4035
			                   3918 3952 3976 3997 3994 3991
			                   3879 3908 3930 3957 3955 3952
			                   3843 3869 3886 3913 3915 3914
			                   3815 3834 3851 3865 3866 3865
			                   3801 3808 3822 3835 3835 3834
			                   3788 3796 3798 3813 3812 3812
			                   3774 3786 3785 3794 3794 3793
			                   3760 3776 3777 3779 3780 3778
			                   3746 3761 3768 3767 3765 3761
			                   3732 3740 3753 3753 3747 3737
			                   3716 3720 3730 3734 3726 3716
			                   3699 3703 3701 3704 3698 3688
			                   3672 3683 3677 3680 3674 3664
			                   3663 3677 3673 3679 3672 3662
			                   3654 3671 3669 3677 3670 3660
			                   3642 3664 3665 3673 3668 3657
			                   3627 3655 3659 3666 3662 3652
			                   3607 3638 3645 3648 3649 3638
			                   3580 3611 3619 3608 3613 3603
			                   3541 3568 3574 3550 3559 3551
			                   3487 3506 3508 3476 3488 3482
			                   3400 3413 3414 3373 3387 3384
			                   3200 3200 3200 3200 3200 3200
			                  >;
		};
};
