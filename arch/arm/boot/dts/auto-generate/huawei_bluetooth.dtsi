/*
 *  Copyright (C) 2013 Huawei co Ltd.
 *
 *  This program is free software; you can redistribute it and/or modify
 *  it under the terms of the GNU General Public License version 2 as
 *  publishhed by the Free Software Foundation.
 */

/ {
    bluetooth_power:bluetooth_power{
        compatible = "huawei,bluetooth_power";
        huawei,bt_en = <162>;
        huawei,bt_wake_host = <213>;
        huawei,host_wake_bt = <164>;
        /*huawei,bt_power-supply = <&buck5>;*/
        clocks = <&clk_pmu32kb>;
        clock-names = "apb_pclk";
        /*pinctrl-names = "default";
        pinctrl-0 = <&uart4_pmx_func &uart4_cfg_func>;*/
        status = "disabled";
    };

	bluetooth_sleep:bluetooth_sleep{
        compatible = "huawei,bluetooth_sleep";
		sleep_handle_name = <&bluetooth_power>;
        status = "disabled";
    };
};
