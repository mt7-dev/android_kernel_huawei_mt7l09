/*
 * Hisilicon Ltd.
 *
 * A15x4 A7x4
 *
 * It is only a demo for hisilicon hi3630 board. You show change the
 * address of each node according to datasheet.
 */

/dts-v1/;


/include/ "MOGOLIA_TL_V3_noNFC_config.dtsi"
/include/ "hisi_3630_pin_MOGOLIA_TL_CMCC_CERTIFICATION_noNFC.dtsi"
/include/ "hisi_3630_modem_MOGOLIA_TL_CMCC_CERTIFICATION_noNFC.dtsi"
/ {
	board_info: board_info {
		hisi,boardid = <1 2 7>;
		hisi,boardname = "Mogolia_TL_CMCC_Certification_noNFC";
		hisi,modem_id = <0x3FF10D00>;
		hw,public;
	};
};
