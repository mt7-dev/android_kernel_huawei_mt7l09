/ {
	touchscreen {
		compatible = "huawei,touchscreen";
		bus_type = "i2c";
		bus_id = <1>;
		product = "mogolia";
		has_virtualkey = <0>;
		lcd_full = <1375>;
		virtual_keys = /* KeyCode CenterX CenterY Width Height */
		/* KEY_BACK */
		<158 142 1342 150 100
		/* KEY_HOME(172) */
		172 360 1342 150 100
		/* KEY_MENU */
		139 578 1342 150 100>;
		support_chip_name = "synaptics", "cypress";
		synaptics: touchscreen@70 {
			compatible = "synaptics";
			/*0-S3207, 1-S3350, 2-3320*/
			ic_type = <2>;
			x_max = <1080>;
			y_max = <1920>;
			x_max_mt = <1080>;
			y_max_mt = <1920>;
			unite_cap_test_interface =<1>;
			report_rate_test =<1>;
			vci_gpio_type = <0>;
			vci_regulator_type = <1>;
			vddio_gpio_type = <0>;
			vddio_regulator_type = <1>;
			vci_ctrl_gpio = <&gpio2 4 0>;
			vddio_ctrl_gpio = <&gpio2 4 0>;
			slave_address = <0x70>;
			pinctrl-names = "default", "idle";
			pinctrl-0 = <&gpio161_cfg_func &gpio200_cfg_func>;
			pinctrl-1 = <&gpio161_cfg_idle &gpio200_cfg_idle>;
			synaptics-vdd-supply = <&ldo17>;
			synaptics-io-supply = <&lsw50>;
			reset_gpio = <&gpio20 1 0>;
			attn_gpio = <&gpio25 0 0>;
			irq_config = <0>;
			algo_id = <1>;
			raw_data_limit = "0",/*rawdata-max*/
					 "0", /*rawdata-min*/
					 "0",/*deltadata-max*/
					 "0",/*deltadata-min*/
					 "0",/*rx-to-rx-diff-max*/
					 "0", /*rx-to-rx-diff-min*/
					 "0", /*tx-to-tx-diff-max*/
					 "0";/*tx-to-tx-diff-min*/
		};
		cypress: touchscreen@1a {
			compatible = "cypress";
			slave_address = <0x1a>;
			attn_gpio = <&gpio25 0 0>;
			reset_gpio = <&gpio20 1 0>;
			irq_config = <3>;
			algo_id = <1>;
		};
	};
};
