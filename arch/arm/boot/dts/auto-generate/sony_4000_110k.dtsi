/* DO NOT EDIT - Automatically generated by python */
/ {
		sony_4000_110k:sony_4000_110k {
			fcc = <4000>;
			default_rbatt_mohm = <100>;
			id_identify_min = <1394>;
			id_identify_max = <1702>;
			id_voltage_min = <1484>;
			id_voltage_max = <1606>;
			vbat_max = <4352>;
			temp_para = 
						"-32767","0","-1","0","4100","0",
						"0","10","-1","1200","4352","3",
						"10","45","-1","-1","4352","3",
						"45","50","-1","820","4352","3",
						"50","32767","-1","0","4352","0";
			vbat_para = 
						"-32767","3400","-1","820","0",
						"3400","32767","-1","-1","0";
			segment_para = 
						"-32767","4150","4000","4208","50",
						"4150","4450","2000","4352","0";
			batt_brand = "sony";
			fcc_temp = <3987 4018 4039 4085 4054 4026>;
			fcc_sf_x = <0 100 200 300 400 500>;
			fcc_sf_y = <100 96 94 92 90 88>;
			fcc_sf_cols = <6>;
			pc_sf_rows = <1>;
			pc_sf_cols = <1>;
			pc_sf_row_entries = <0>;
			pc_sf_percent = <100>;
			pc_sf_sf = <100>;
			rbatt_sf_rows = <28>;
			rbatt_sf_cols = <6>;
			rbatt_sf_percent = <100 95 90 85 80 75 70 65 60 55 50 45 40 35 30 25 20 15 10 9 8 7 6 5 4 3 2 1>;
			rbatt_sf_sf = <
			               973 453 258 130 113 108
			               973 453 258 130 113 108
			               981 476 275 135 116 109
			               971 485 291 141 119 110
			               980 493 305 147 122 112
			               941 466 316 156 127 114
			               964 446 283 168 133 117
			               992 456 271 176 144 123
			               1009 466 269 162 147 132
			               1034 479 271 138 124 117
			               1093 496 276 136 117 111
			               1149 513 283 139 118 111
			               1202 524 295 141 121 112
			               1268 534 307 145 124 115
			               1344 546 323 146 124 115
			               1453 565 329 144 119 111
			               1605 563 325 141 118 112
			               1857 673 319 137 117 112
			               2299 797 350 139 120 114
			               2184 765 355 138 120 114
			               2231 807 367 140 121 115
			               2452 863 387 142 121 115
			               2779 909 401 143 120 113
			               3176 959 395 145 121 112
			               3720 1014 402 165 122 114
			               4562 1173 434 200 134 119
			               5861 1481 503 229 175 140
			               8127 2005 597 206 212 183
			              >;
			pc_temp_ocv_rows = <29>;
			pc_temp_ocv_cols = <6>;
			pc_temp_ocv_percent = <100 95 90 85 80 75 70 65 60 55 50 45 40 35 30 25 20 15 10 9 8 7 6 5 4 3 2 1>;
			pc_temp_ocv_ocv = <
			                   4329 4327 4324 4320 4312 4305
			                   4251 4255 4255 4253 4247 4242
			                   4187 4198 4198 4197 4191 4187
			                   4125 4142 4143 4143 4138 4134
			                   4074 4090 4091 4092 4088 4084
			                   4005 4029 4043 4044 4041 4038
			                   3954 3973 3983 4000 3998 3996
			                   3910 3932 3937 3958 3959 3958
			                   3867 3892 3899 3913 3918 3920
			                   3825 3859 3866 3871 3873 3874
			                   3794 3830 3838 3842 3843 3842
			                   3770 3806 3813 3820 3820 3819
			                   3751 3785 3794 3801 3802 3801
			                   3738 3768 3778 3786 3787 3785
			                   3725 3754 3768 3771 3770 3766
			                   3714 3741 3755 3754 3749 3737
			                   3702 3710 3733 3732 3726 3714
			                   3686 3694 3704 3702 3697 3685
			                   3657 3678 3676 3677 3671 3660
			                   3653 3672 3672 3674 3669 3658
			                   3644 3665 3668 3670 3665 3654
			                   3632 3657 3663 3664 3660 3648
			                   3616 3646 3653 3652 3648 3634
			                   3593 3625 3631 3624 3618 3604
			                   3560 3588 3591 3581 3574 3560
			                   3512 3535 3536 3528 3519 3505
			                   3446 3465 3466 3460 3450 3436
			                   3350 3371 3371 3362 3355 3343
			                   3200 3200 3200 3200 3200 3200
			                  >;
		};
};
