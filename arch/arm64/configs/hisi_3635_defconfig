## arch/arm64/configs/hisi_3635_defconfig
```kconfig
CONFIG_ARCH_HI3XXX=y
CONFIG_HISI_3635=y
CONFIG_HISILICON_PLATFORM=y
CONFIG_ARCH_KIRIN=y
CONFIG_EXPERIMENTAL=y
CONFIG_HISILICON_PLATFORM_MAINTAIN=y
CONFIG_LOCALVERSION_AUTO=y
CONFIG_SYSVIPC=y
CONFIG_POSIX_MQUEUE=y
CONFIG_BSD_PROCESS_ACCT=y
CONFIG_BSD_PROCESS_ACCT_V3=y
CONFIG_NO_HZ=y
CONFIG_HIGH_RES_TIMERS=y
CONFIG_IKCONFIG=y
CONFIG_LOG_BUF_SHIFT=20
CONFIG_BLK_DEV_INITRD=y
CONFIG_PANIC_TIMEOUT=1
CONFIG_KALLSYMS_ALL=y
CONFIG_COMPAT_BRK=y
CONFIG_PROFILING=y
CONFIG_MODULES=y
CONFIG_MODULE_UNLOAD=y
CONFIG_BLK_DEV_BSG=y
CONFIG_IOSCHED_DEADLINE=y
CONFIG_ARM64_ERRATUM_845719=y
CONFIG_SMP=y
CONFIG_NR_CPUS=8
CONFIG_HOTPLUG_CPU=y
CONFIG_CMDLINE="console=ttyAMA0"
# CONFIG_CORE_DUMP_DEFAULT_ELF_HEADERS is not set
CONFIG_COMPAT=y
CONFIG_ARMV7_COMPAT=y
CONFIG_UEVENT_HELPER_PATH="/sbin/hotplug"
CONFIG_DEVTMPFS=y
CONFIG_DEVMEM=n
CONFIG_DEVKMEM=n
CONFIG_SHRINK_MEMORY=y
CONFIG_PROCESS_RECLAIM=y
#
# SCSI device support
#
CONFIG_SCSI_MOD=y
CONFIG_SCSI=y
CONFIG_SCSI_DMA=y
CONFIG_BLK_DEV_SD=y
CONFIG_SCSI_MULTI_LUN=y

# CONFIG_SERIO_I8042 is not set
CONFIG_LEGACY_PTY_COUNT=16
CONFIG_SERIAL_AMBA_PL011=y
CONFIG_SERIAL_AMBA_PL011_CONSOLE=y
# CONFIG_HW_RANDOM is not set

#
## Power management options
#
CONFIG_SUSPEND=y
CONFIG_SUSPEND_FREEZER=y
CONFIG_HAS_WAKELOCK=y
CONFIG_WAKELOCK=y
CONFIG_PM_SLEEP=y
CONFIG_PM_SLEEP_SMP=y
CONFIG_PM_AUTOSLEEP=y
CONFIG_PM_WAKELOCKS=y
CONFIG_PM_WAKELOCKS_LIMIT=100
CONFIG_PM_WAKELOCKS_GC=y
CONFIG_PM_RUNTIME=y
CONFIG_PM=y
CONFIG_HISI_SR=y
CONFIG_HI3XXX_SR=y
CONFIG_HI3XXX_SR_DEBUG=y
CONFIG_HI3XXX_SR_DEBUG_SLEEP=y
CONFIG_HISI_HMPTH_SET=y

CONFIG_SYNC=y
CONFIG_SW_SYNC=y
CONFIG_SW_SYNC_USER=y
#
# Graphics support
#
CONFIG_FB=y
# CONFIG_FB_FAKE is not set
# CONFIG_FB_VIRTUAL is not set
# CONFIG_FB_3630 is not set
CONFIG_FB_3635=y
# CONFIG_FB_3650 is not set
# CONFIG_FASTBOOT_DISP_ENABLE is not set

# CONFIG_BACKLIGHT_LCD_SUPPORT is not set
# CONFIG_BACKLIGHT_CLASS_DEVICE is not set

CONFIG_LCD_CLASS_DEVICE=y
CONFIG_NEW_LEDS=y
CONFIG_LEDS_CLASS=y
CONFIG_LEDS_TRIGGERS=y
CONFIG_LEDS_TRIGGER_TIMER=y

# CONFIG_VGA_CONSOLE is not set
CONFIG_FRAMEBUFFER_CONSOLE=y
CONFIG_LOGO=y
# CONFIG_LOGO_LINUX_MONO is not set
# CONFIG_LOGO_LINUX_VGA16 is not set

# jpeg support drivers
CONFIG_JPEG_CODEC=y

# vcodec support drivers
#
CONFIG_IMAGINATION_VCODEC=y

CONFIG_IMG_DEC=y
CONFIG_IMG_VIDEO=y
#
# img encode support
#
CONFIG_IMG_ENC=y
CONFIG_HIK3_VPP=y

CONFIG_BLOCK=y
CONFIG_HAS_IOMEM=y
CONFIG_HISI_BLOCK_FREQUENCE_CONTROL=y

CONFIG_MMC=y
CONFIG_HUAWEI_SDCARD_DSM=y
CONFIG_HUAWEI_EMMC_DSM=y
# CONFIG_HUAWEI_EMMC_DSM_ONLY_VDET is not set
# CONFIG_MMC_DEBUG is not set
CONFIG_MMC_ARMMMCI=y
CONFIG_MMC_UNSAFE_RESUME=y
# MMC/SD/SDIO Card Drivers
CONFIG_MMC_BLOCK=y
CONFIG_MMC_BLOCK_MINORS=40
# CONFIG_MMC_BLOCK_BOUNCE is not set
# CONFIG_MMC_BLOCK_DEFERRED_RESUME is not set
CONFIG_MMC_FFU=y
CONFIG_MMC_FFU_SAMSUNG45=y
# MMC/SD/SDIO Host Controller Drivers
CONFIG_MMC_DW=y
CONFIG_MMC_DW_IDMAC=y
CONFIG_MMC_DW_PLTFM=y
CONFIG_MMC_DW_HI3XXX=y
CONFIG_EXT2_FS=y
CONFIG_EXT3_FS=y
CONFIG_EXT4_FS=y
CONFIG_EXT4_FS_SECURITY=y
CONFIG_FEATURE_HUAWEI_EMERGENCY_DATA=y
CONFIG_HUAWEI_FS_DSM=y
# CONFIG_EXT3_DEFAULTS_TO_ORDERED is not set
# CONFIG_EXT3_FS_XATTR is not set
CONFIG_FUSE_FS=y
CONFIG_CUSE=y
CONFIG_TMPFS=y
CONFIG_SDCARD_FS=y
CONFIG_NFS_FS=y
CONFIG_ROOT_NFS=y

# CONFIG exfat module
CONFIG_NLS_UTF8=y

CONFIG_NLS_CODEPAGE_437=y
CONFIG_NLS_ISO8859_1=y
CONFIG_MAGIC_SYSRQ=y
CONFIG_DEBUG_FS=y
CONFIG_DEBUG_KERNEL=y
# CONFIG_SCHED_DEBUG is not set
CONFIG_DEBUG_INFO=y
CONFIG_ATOMIC64_SELFTEST=y
CONFIG_PRINTK_TIME=y
CONFIG_HISI_TIME=y

#
# DOS/FAT/NT Filesystems
#
CONFIG_FAT_FS=y
CONFIG_MSDOS_FS=y
CONFIG_VFAT_FS=y
CONFIG_FAT_DEFAULT_CODEPAGE=437
CONFIG_FAT_DEFAULT_IOCHARSET="iso8859-1"
CONFIG_EXFAT_FS=y
CONFIG_EXFAT_DEFAULT_CODEPAGE=437
CONFIG_EXFAT_DEFAULT_IOCHARSET="utf8"
CONFIG_NTFS_FS=y
CONFIG_NTFS_RW=y

#
# Android Base Configure
#
#  KEEP ALPHABETICALLY SORTED
CONFIG_ANDROID=y
CONFIG_ANDROID_BINDER_IPC=y
CONFIG_ANDROID_INTF_ALARM_DEV=y
CONFIG_ANDROID_LOGGER=y
CONFIG_ANDROID_LOW_MEMORY_KILLER=y
CONFIG_ASHMEM=y
CONFIG_CGROUPS=y
CONFIG_CGROUP_CPUACCT=y
CONFIG_CGROUP_DEBUG=y
CONFIG_CGROUP_FREEZER=y
CONFIG_CGROUP_SCHED=y
CONFIG_CGROUP_IONICE=y
CONFIG_CPUSETS=y
CONFIG_PROC_PID_CPUSET=y
CONFIG_EMBEDDED=y
CONFIG_EXPERIMENTAL=y
CONFIG_COMPACTION=y

#
#spi
#
CONFIG_SPI=y
CONFIG_SPI_MASTER=y
CONFIG_SPI_DEBUG=n
CONFIG_SPI_PL022=y
#CONFIG_SPI_SPIDEV=y CONFIG_SPI_SPIDEV is not set


#
# Networking options
#
CONFIG_NET=y
CONFIG_PACKET=y
CONFIG_UNIX=y
CONFIG_NET_KEY=y
CONFIG_INET=y
CONFIG_IP_PNP=y
CONFIG_IP_PNP_DHCP=y
CONFIG_IP_MULTIPLE_TABLES=y
CONFIG_IP_ADVANCED_ROUTER=y
CONFIG_INET_ESP=y
CONFIG_IP_ROUTE_VERBOSE=y
CONFIG_IP_ROUTE_MULTIPATH=y
CONFIG_IP_ROUTE_MULTIPATH_CACHED=y
CONFIG_PM_DEBUG=y
CONFIG_IPV6=y
CONFIG_NF_CONNTRACK_IPV6=y
CONFIG_IP6_NF_TARGET_REJECT_SKERR=y
CONFIG_IPV6_PRIVACY=y
CONFIG_IPV6_ROUTER_PREF=y
CONFIG_IPV6_ROUTE_INFO=y
CONFIG_IPV6_OPTIMISTIC_DAD=y
CONFIG_INET6_AH=y
CONFIG_INET6_ESP=y
CONFIG_INET6_IPCOMP=y
CONFIG_IPV6_MIP6=y
CONFIG_IPV6_MULTIPLE_TABLES=y
CONFIG_IPV6_SUBTREES=y
CONFIG_NETFILTER=y
CONFIG_NETFILTER_ADVANCED=y

#
# PPP
#
CONFIG_PPP=y
CONFIG_PPP_MULTILINK=y
CONFIG_PPP_FILTER=y
CONFIG_PPP_ASYNC=y
CONFIG_PPP_SYNC_TTY=y
CONFIG_PPP_DEFLATE=y
CONFIG_PPP_BSDCOMP=y
CONFIG_PPP_MPPE=y
CONFIG_PPPOE=m
CONFIG_PPPOL2TP=y
CONFIG_PPPOLAC=y
CONFIG_PPPOPNS=y
CONFIG_PPPOATM=y
CONFIG_PPPOESTA=y
CONFIG_SLHC=y
CONFIG_TUN=y

#
# Core Netfilter Configuration
#
CONFIG_NETFILTER_NETLINK=y
# CONFIG_NETFILTER_NETLINK_ACCT is not set
CONFIG_NETFILTER_NETLINK_QUEUE=y
CONFIG_NETFILTER_NETLINK_LOG=y
CONFIG_NF_CONNTRACK=y
CONFIG_NF_CONNTRACK_MARK=y
CONFIG_NF_CONNTRACK_PROCFS=y
CONFIG_NF_CONNTRACK_EVENTS=y
CONFIG_NF_CT_PROTO_DCCP=y
CONFIG_NF_CT_PROTO_GRE=y
CONFIG_NF_CT_PROTO_SCTP=y
CONFIG_NF_CT_PROTO_UDPLITE=y
CONFIG_NF_CONNTRACK_AMANDA=y
CONFIG_NF_CONNTRACK_FTP=y
CONFIG_NF_CONNTRACK_H323=y
CONFIG_NF_CONNTRACK_IRC=y
CONFIG_NF_CONNTRACK_BROADCAST=y
CONFIG_NF_CONNTRACK_NETBIOS_NS=y
CONFIG_NF_CONNTRACK_PPTP=y
CONFIG_NF_CONNTRACK_SANE=y
CONFIG_NF_CONNTRACK_SIP=y
CONFIG_NF_CONNTRACK_TFTP=y
CONFIG_NF_CT_NETLINK=y
CONFIG_NF_NAT=y
CONFIG_NF_NAT_NEEDED=y
CONFIG_NF_NAT_PROTO_DCCP=y
CONFIG_NF_NAT_PROTO_UDPLITE=y
CONFIG_NF_NAT_PROTO_SCTP=y
CONFIG_NF_NAT_AMANDA=y
CONFIG_NF_NAT_FTP=y
CONFIG_NF_NAT_IRC=y
CONFIG_NF_NAT_SIP=y
CONFIG_NF_NAT_TFTP=y
CONFIG_NETFILTER_TPROXY=y
CONFIG_NETFILTER_XTABLES=y

#
# Xtables combined modules
#
CONFIG_NETFILTER_XT_MARK=y
CONFIG_NETFILTER_XT_CONNMARK=y
CONFIG_NETFILTER_XT_TARGET_CLASSIFY=y
CONFIG_NETFILTER_XT_TARGET_CONNMARK=y
CONFIG_NETFILTER_XT_TARGET_IDLETIMER=y
CONFIG_NETFILTER_XT_TARGET_MARK=y
CONFIG_NETFILTER_XT_TARGET_NFQUEUE=y
CONFIG_NETFILTER_XT_TARGET_NFLOG=y
CONFIG_NETFILTER_XT_TARGET_REDIRECT=y
CONFIG_NETFILTER_XT_MATCH_COMMENT=y
CONFIG_NETFILTER_XT_MATCH_CONNBYTES=y
CONFIG_NETFILTER_XT_MATCH_CONNLIMIT=y
CONFIG_NETFILTER_XT_MATCH_CONNMARK=y
CONFIG_NETFILTER_XT_MATCH_CONNTRACK=y
CONFIG_NETFILTER_XT_MATCH_HASHLIMIT=y
CONFIG_NETFILTER_XT_MATCH_HELPER=y
CONFIG_NETFILTER_XT_MATCH_IPRANGE=y
CONFIG_NETFILTER_XT_MATCH_LENGTH=y
CONFIG_NETFILTER_XT_MATCH_LIMIT=y
CONFIG_NETFILTER_XT_MATCH_MAC=y
CONFIG_NETFILTER_XT_MATCH_MARK=y
CONFIG_NETFILTER_XT_MATCH_MULTIPORT=y
CONFIG_NETFILTER_XT_MATCH_POLICY=y
CONFIG_NETFILTER_XT_MATCH_PKTTYPE=y
CONFIG_NETFILTER_XT_MATCH_QUOTA=y
CONFIG_NETFILTER_XT_MATCH_QUOTA2=y
CONFIG_NETFILTER_XT_MATCH_QUOTA2_LOG=y
CONFIG_NETFILTER_XT_MATCH_SOCKET=y
CONFIG_NETFILTER_XT_MATCH_STATE=y
CONFIG_NETFILTER_XT_MATCH_STATISTIC=y
CONFIG_NETFILTER_XT_MATCH_STRING=y
CONFIG_NETFILTER_XT_MATCH_TIME=y
CONFIG_NETFILTER_XT_MATCH_U32=y
CONFIG_NETFILTER_XT_MATCH_QTAGUID=y
CONFIG_NF_DEFRAG_IPV4=y
CONFIG_NF_CONNTRACK_IPV4=y
CONFIG_NF_CONNTRACK_PROC_COMPAT=y
CONFIG_IP_NF_IPTABLES=y
CONFIG_IP_NF_MATCH_AH=y
CONFIG_IP_NF_MATCH_ECN=y
CONFIG_IP_NF_MATCH_TTL=y
CONFIG_IP_NF_FILTER=y
CONFIG_IP_NF_TARGET_REJECT=y
CONFIG_IP_NF_TARGET_LOG=y
CONFIG_NF_NAT_IPV4=y
CONFIG_IP_NF_TARGET_MASQUERADE=y
CONFIG_IP_NF_TARGET_NETMAP=y
CONFIG_IP_NF_TARGET_REDIRECT=y
CONFIG_NF_NAT_PROTO_GRE=y
CONFIG_NF_NAT_PPTP=y
CONFIG_NF_NAT_H323=y
CONFIG_IP_NF_MANGLE=y
CONFIG_IP_NF_RAW=y
CONFIG_IP_NF_ARPTABLES=y
CONFIG_IP_NF_ARPFILTER=y
CONFIG_IP_NF_ARP_MANGLE=y
CONFIG_NF_DEFRAG_IPV6=y
CONFIG_IP6_NF_IPTABLES=y
CONFIG_IP6_NF_FILTER=y
CONFIG_IP6_NF_TARGET_REJECT=y
CONFIG_IP6_NF_MANGLE=y
CONFIG_IP6_NF_RAW=y
CONFIG_NET_SCHED=y
CONFIG_NET_SCH_HTB=y
CONFIG_NET_CLS_U32=y
CONFIG_NET_EMATCH=y
CONFIG_NET_EMATCH_U32=y
CONFIG_NET_CLS_ACT=y
CONFIG_NET_ACT_POLICE=y
CONFIG_NET_ACT_GACT=y
CONFIG_NET_ACT_MIRRED=y
CONFIG_HAVE_NET_DSA=y
CONFIG_RPS=y
CONFIG_RFS_ACCEL=y
CONFIG_XPS=y
CONFIG_BQL=y
CONFIG_CMA=y
CONFIG_CMA_DEBUG=y

CONFIG_NETDEVICES=y
CONFIG_NET_CORE=y

#wifi
CONFIG_WLAN=y
CONFIG_WIRELESS=y
CONFIG_BCMDHD=y
CONFIG_BCM4334=y
CONFIG_WIFI_CONTROL_FUNC=y
CONFIG_BCMDHD_FW_PATH="/vendor/firmware/fw_bcm4334_hw.bin"
CONFIG_BCMDHD_NVRAM_PATH="/vendor/firmware/nvram4334_hw.txt"
CONFIG_CFG80211=y
CONFIG_BCM_VIO=y
CONFIG_HW_WIFI_FREQ_CTRL_FLAG=y
CONFIG_HWCONNECTIVITY=y

CONFIG_PREEMPT=y
CONFIG_RESOURCE_COUNTERS=y
CONFIG_RT_GROUP_SCHED=y
CONFIG_STAGING=y
CONFIG_ARCH_HAS_PASR=y
CONFIG_PASR=y
CONFIG_HI3635_PASR=y
CONFIG_PASR_DEBUG=y
CONFIG_SWITCH=y
CONFIG_XFRM_USER=y
CONFIG_SWITCH_FSA9685=y
CONFIG_SWITCH_USB_CLS=y
CONFIG_FSA9685_DEBUG_FS=y
CONFIG_SWITCH_OTGID_GPIO=y
CONFIG_HUAWEI_TYPEC=y
CONFIG_HUAWEI_TYPEC_TUSB320=y
CONFIG_HUAWEI_TYPEC_PERICOM30216=y

#
#ipc support
#
CONFIG_HI3XXX_MAILBOX=y
CONFIG_HISI_MAILBOX_DEBUGFS=y
CONFIG_HI3XXX_RPROC=y
CONFIG_HISI_RPROC_DEBUGFS=y
CONFIG_HI3XXX_MODEM_ETB=y

#hifi_mailbox
CONFIG_HIFI_MAILBOX=y
CONFIG_HIFI_IPC=y

CONFIG_MFD_HI6402_IRQ=y
CONFIG_MFD_HI3630_ASP_IRQ=y
CONFIG_BLK_DEV_RAM=y
CONFIG_BLK_DEV_RAM_COUNT=4
CONFIG_BLK_DEV_RAM_SIZE=8192
CONFIG_BLK_DEV_XIP=y
CONFIG_CDROM_PKTCDVD=y
CONFIG_CDROM_PKTCDVD_BUFFERS=8
CONFIG_SND_SOC=y
CONFIG_SND_SOC_PCM_HI3630=y
CONFIG_SND_SOC_HI6402=y
CONFIG_HI6402_MBHC=y
CONFIG_HI6402_HIFI_MISC=y
CONFIG_SND_HI3630_HI6402=y
# CONFIG_MFD_HI6401_IRQ is not set
# CONFIG_SND_SOC_HI6401 is not set
# CONFIG_SND_HI3630_HI6401 is not set
# CONFIG_SND_SOC_PCM_HI6210 is not set

#hifi dsp
CONFIG_HISILICON_PLATFORM_HIFI_DSP=y

# CONFIG_SND_HIFI_LPP_HI6XXX is not set
# CONFIG_SND_HIFI_LOAD_HI6XXX is not set
# CONFIG_SND_HIFI_SEC_LOAD_HI6XXX is not set
#
#audio device
CONFIG_SPEAKERID=y
CONFIG_MAX98925=y
CONFIG_TFA9895=y
CONFIG_ANC_HS=y

#irq affinity support
#
CONFIG_HI3XXX_IRQ_AFFINITY=y
CONFIG_HI3XXX_IRQ_AFFINITY_DEBUGFS=y

#
# pm opp support
#
CONFIG_PM_OPP=y

#
# devfreq support
#
CONFIG_PM_DEVFREQ=y

#
# DDR devfreq support
#
CONFIG_HI3XXX_DDR_DEVFREQ=y
CONFIG_HI3XXX_DDR_DEVFREQ_DEBUGFS=y

#
# CLK CONTROLL
#
CONFIG_HI3XXX_CLK=y
CONFIG_COMMON_CLK_DEBUG=y
CONFIG_HISI_CLK_DEBUG=y
# CONFIG_HI3XXX_CLK_ALWAYS_ON is not set
CONFIG_HI3XXX_CLK_MAILBOX_SUPPORT=y
CONFIG_INPUT_GPIO=y

CONFIG_SERIO_SERPORT=y
CONFIG_DMA_SHARED_BUFFER=y
# DMA
CONFIG_DMADEVICES=y
CONFIG_HAS_DMA=y
CONFIG_DMA_ENGINE=y
CONFIG_DMA_VIRTUAL_CHANNELS=y
CONFIG_HISI_DMA=y
CONFIG_NEED_SG_DMA_LENGTH=y
CONFIG_DMA_NO_CCI=y
# CONFIG_HISI_DMA_PM_RUNTIME is not set
CONFIG_DMATEST=n

#DTS add
CONFIG_DTS_EAGLE=y

#
# I2C Hardware Bus support
#
CONFIG_I2C=y
CONFIG_I2C_BOARDINFO=y
CONFIG_I2C_COMPAT=y
CONFIG_I2C_HELPER_AUTO=y
# CONFIG_I2C_CHARDEV is not set

#
# I2C system bus drivers (mostly embedded / system-on-chip)
#
CONFIG_I2C_DESIGNWARE_CORE=y
CONFIG_I2C_DESIGNWARE_PLATFORM=y
CONFIG_I2C_DESIGNWARE_HI3XXX=y
CONFIG_HISI_I2C_DESIGNWARE=y

#
#Touchscreen Driver
CONFIG_INPUT=y
# CONFIG_INPUT_TOUCHSCREEN is not set
# CONFIG_TOUCHSCREEN_SYNAPTICS_I2C_RMI is not set
CONFIG_INPUT_EVDEV=y
CONFIG_HUAWEI_TP_COLOR_INFO=y

#Huawei dsm module
CONFIG_HUAWEI_DSM=y
#Huawei touchscreen driver
CONFIG_HUAWEI_TS=y
CONFIG_SYNAPTICS_TS=y
CONFIG_HIDEEP_TS=y
CONFIG_CYPRESS_TS=y
CONFIG_WACOM_TS=y
CONFIG_HI3635_TS_FW_BUILD=y
CONFIG_HI3630_TS_FW_BUILD=n
CONFIG_HI6220_TS_FW_BUILD=n
CONFIG_SYNAPTICS_LCD_TYPE=y
#Drv2605 vibrator
CONFIG_DRV2605=y
#ate
#CONFIG_INPUT_HW_ATE is not set

#
#cyttsp4
#
# CONFIG_TOUCHSCREEN_CYPRESS_CYTTSP4 is not set
# CONFIG_TOUCHSCREEN_CYPRESS_CYTTSP4_DEVICETREE_SUPPORT is not set
# CONFIG_CYTTSP4_PLATFORM is not set
# CONFIG_CYPRESS_CYTTSP4_BUS is not set
# CONFIG_TOUCHSCREEN_CYPRESS_CYTTSP4_USE_FW_BIN_FILE is not set
# CONFIG_TOUCHSCREEN_CYPRESS_CYTTSP4_I2C is not set
# CONFIG_TOUCHSCREEN_CYPRESS_CYTTSP4_SPI is not set
# CONFIG_TOUCHSCREEN_CYPRESS_CYTTSP4_MT_A is not set
# CONFIG_TOUCHSCREEN_CYPRESS_CYTTSP4_BUTTON is not set
# CONFIG_TOUCHSCREEN_CYPRESS_CYTTSP4_MT_B is not set
# CONFIG_TOUCHSCREEN_CYPRESS_CYTTSP4_DEVICE_ACCESS is not set
# CONFIG_TOUCHSCREEN_CYPRESS_CYTTSP4_LOADER is not set
# CONFIG_TOUCHSCREEN_CYPRESS_CYTTSP4_DEBUG is not set
# CONFIG_TOUCHSCREEN_CYPRESS_CYTTSP4_VDEBUG is not set
# CONFIG_TOUCHSCREEN_CYPRESS_CYTTSP4_DEBUG_MODULE is not set
# CONFIG_TOUCHSCREEN_CYPRESS_CYTTSP4_PLATFORM_FW_UPGRADE is not set
# CONFIG_TOUCHSCREEN_CYPRESS_CYTTSP4_BINARY_FW_UPGRADE is not set
# CONFIG_TOUCHSCREEN_CYPRESS_CYTTSP4_PLATFORM_TTCONFIG_UPGRADE is not set
# CONFIG_TOUCHSCREEN_CYPRESS_CYTTSP4_MANUAL_TTCONFIG_UPGRADE is not set
# CONFIG_TOUCHSCREEN_CYPRESS_CYTTSP4_PROXIMITY is not set
# CONFIG_TOUCHSCREEN_CYPRESS_CYTTSP4_DEVICE_ACCESS_API is not set
# CONFIG_TOUCHSCREEN_CYPRESS_CYTTSP4_TEST_DEVICE_ACCESS_API is not set
# CONFIG_EXTRA_FIRMWARE="cyttsp4_fw.bin"
# CONFIG_EXTRA_FIRMWARE_DIR="firmware"

#
#cyttsp5
#
#CONFIG_CYPRESS_CYTTSP5_BUS is not set
CONFIG_TOUCHSCREEN_CYPRESS_CYTTSP5=y
CONFIG_TOUCHSCREEN_CYPRESS_CYTTSP5_DEVICETREE_SUPPORT=y
# CONFIG_TOUCHSCREEN_CYPRESS_CYTTSP5_DEBUG is not set
CONFIG_TOUCHSCREEN_CYPRESS_CYTTSP5_I2C=y
# CONFIG_TOUCHSCREEN_CYPRESS_CYTTSP5_SPI is not set
# CONFIG_TOUCHSCREEN_CYPRESS_CYTTSP5_MT_A is not set
CONFIG_TOUCHSCREEN_CYPRESS_CYTTSP5_MT_B=y
CONFIG_TOUCHSCREEN_CYPRESS_CYTTSP5_BUTTON=y
CONFIG_TOUCHSCREEN_CYPRESS_CYTTSP5_DEVICE_ACCESS=y
CONFIG_TOUCHSCREEN_CYPRESS_CYTTSP5_LOADER=y
# CONFIG_TOUCHSCREEN_CYPRESS_CYTTSP5_PLATFORM_FW_UPGRADE is not set
CONFIG_TOUCHSCREEN_CYPRESS_CYTTSP5_BINARY_FW_UPGRADE=y
CONFIG_TOUCHSCREEN_CYPRESS_CYTTSP5_PLATFORM_TTCONFIG_UPGRADE=y
CONFIG_TOUCHSCREEN_CYPRESS_CYTTSP5_MANUAL_TTCONFIG_UPGRADE=y
# CONFIG_TOUCHSCREEN_CYPRESS_CYTTSP5_DEBUG_MODULE is not set
#
# GPIO controllers
#
CONFIG_GPIO_PL061=y
CONFIG_GPIO_HI6402=y
CONFIG_ARCH_NR_GPIO=0
CONFIG_ARCH_HAVE_CUSTOM_GPIO_H=y
#CONFIG_ARCH_WANT_OPTIONAL_GPIOLIB is not set
#CONFIG_ARCH_REQUIRE_GPIOLIB is not set
CONFIG_GPIOLIB=y
CONFIG_OF_GPIO=y
# CONFIG_DEBUG_GPIO is not set
CONFIG_GPIO_SYSFS=y
# CONFIG_CONFIG_GPIO_PM_SUPPORT is not set
# mali gpu support
#
CONFIG_MALI_MIDGARD=y
CONFIG_MALI_DEVICE=y
CONFIG_MALI_MIDGARD_RT_PM=y
CONFIG_MALI_PM_DEMAND=y
#
# mali gpu devfreq
#
#
# mali vsync miss
#
CONFIG_REPORT_VSYNC=y

CONFIG_DEVFREQ_GOV_MALI_ONDEMAND=y

CONFIG_SCHEDSTATS=y

#
# Pin controllers
#
CONFIG_PINMUX=y
CONFIG_PINCTRL=y
CONFIG_PINCONF=y
CONFIG_GENERIC_PINCONF=y
CONFIG_PINCTRL_SINGLE=y
CONFIG_PINCTRL_HI6402=y
# CONFIG_DEBUG_PINCTRL is not set

#
# Thermal driver
#
CONFIG_THERMAL_HWMON=y
CONFIG_THERMAL_OF=y
CONFIG_HI3XXX_THERMAL_TSENSOR=y
CONFIG_HI3XXX_THERMAL_PERIPHERAL=y
# CONFIG_THERMAL_EMULATION is not set

#
# Hardware spinlcok
#
CONFIG_HWSPINLOCK=y
CONFIG_HWSPINLOCK_HI3XXX=y
#
#HMP
#
CONFIG_SCHED_MC=y
CONFIG_DISABLE_CPU_SCHED_DOMAIN_BALANCE=y
CONFIG_SCHED_HMP=y
CONFIG_SCHED_HMP_PRIO_FILTER=y
CONFIG_SCHED_HMP_PRIO_FILTER_VAL=5
# CONFIG_SCHED_HMP_LITTLE_PACKING is not set
CONFIG_HMP_FAST_CPU_MASK=""
CONFIG_HMP_SLOW_CPU_MASK=""
CONFIG_HMP_VARIABLE_SCALE=y
CONFIG_HMP_FREQUENCY_INVARIANT_SCALE=y

CONFIG_CFS_BANDWIDTH=y

CONFIG_KSM=y
#
# CPU Frequency scaling
#
#cpufreq core
CONFIG_CPU_FREQ=y
CONFIG_CPU_FREQ_TABLE=y
CONFIG_CPU_FREQ_GOV_COMMON=y
CONFIG_CPU_FREQ_STAT=y
# CONFIG_CPU_FREQ_STAT_DETAILS is not set

#big.little
CONFIG_BIG_LITTLE=y
CONFIG_ARM_BIG_LITTLE_CPUFREQ=y
CONFIG_ARM_DT_BL_CPUFREQ=y
CONFIG_HISI_CPUFREQ=y
# CONFIG_INPUT_PULSE_SUPPORT is not set

#governor
CONFIG_CPU_FREQ_DEFAULT_GOV_PERFORMANCE=y
# CONFIG_CPU_FREQ_DEFAULT_GOV_USERSPACE is not set
# CONFIG_CPU_FREQ_DEFAULT_GOV_ONDEMAND is not set
# CONFIG_CPU_FREQ_DEFAULT_GOV_CONSERVATIVE is not set
# CONFIG_CPU_FREQ_DEFAULT_GOV_INTERACTIVE is not set
CONFIG_CPU_FREQ_GOV_PERFORMANCE=y
CONFIG_CPU_FREQ_GOV_POWERSAVE=y
CONFIG_CPU_FREQ_GOV_USERSPACE=y
CONFIG_CPU_FREQ_GOV_ONDEMAND=y
CONFIG_CPU_FREQ_GOV_INTERACTIVE=y
CONFIG_CPU_FREQ_GOV_CONSERVATIVE=y

#
#CPUIDLE support
#
CONFIG_GENERIC_CLOCKEVENTS_BROADCAST=y
CONFIG_CPU_IDLE=y
CONFIG_CPU_IDLE_MULTIPLE_DRIVERS=y
# CONFIG_CPU_IDLE_GOV_LADDER is not set
CONFIG_CPU_IDLE_GOV_MENU=y
CONFIG_OF_IDLE_STATES=y
CONFIG_ARM64_CPUIDLE=y

CONFIG_ARM_TIMER_SP804=y

#
# Misc devices
#
CONFIG_APANIC=y
CONFIG_APANIC_PLABEL="splash"
CONFIG_APANIC_MMC=y

#
# Hisi log support
#
CONFIG_HISI_LOG=y

#
# SYSTEM off and reset
#
CONFIG_HISI_REBOOT_TYPE=y
CONFIG_HI3XXX_POWER_OFF=y

#
# PMU
#
CONFIG_REGULATOR=y
CONFIG_HI3XXX_HI6421V300_PMIC=y
CONFIG_HI3XXX_REGULATOR_HI6421V300=y
CONFIG_HI3XXX_HI3630_CORE=y
CONFIG_HI3XXX_REGULATOR_KIRIN930=y
CONFIG_HI6421_VIBRATOR=y
CONFIG_LEDS_HI6421=y
CONFIG_INPUT_KEYBOARD=y
CONFIG_KEYBOARD_HISI_GPIO_KEY=y
CONFIG_INPUT_MISC=y
CONFIG_HISI_BOOST5V_CONTROL=y
CONFIG_HISI_POWERKEY=y

CONFIG_RTC_CLASS=y
CONFIG_RTC_HCTOSYS=y
CONFIG_RTC_HCTOSYS_DEVICE="rtc0"
#
# RTC interfaces
#
CONFIG_RTC_INTF_SYSFS=y
CONFIG_RTC_INTF_PROC=y
CONFIG_RTC_INTF_DEV=y
#
# on-CPU RTC drivers
#
# CONFIG_RTC_DRV_PL030 is not set
CONFIG_RTC_DRV_PL031=y

#
#thermal monitor
#
CONFIG_THERMAL=y
CONFIG_THERMAL_TSENSOR=y
CONFIG_THERMAL_PERIPHERAL=y

#
# PMU RTC
#
CONFIG_RTC_DRV_HI3635_PMU=y
# CONFIG_RTC_DRV_HI6421V300 is not set

#
# USB HID support
#
CONFIG_USB_HID=y

#
# USB
#
CONFIG_HW_GADGET=y
CONFIG_USB_SUPPORT=y
CONFIG_USB_COMMON=y
CONFIG_USB_ARCH_HAS_HCD=y
CONFIG_USB=y
CONFIG_USB_DEFAULT_PERSIST=y

CONFIG_USB_STORAGE=y

CONFIG_USB_SUSB_HDRC=y
CONFIG_USB_SUSB_PCD=y
CONFIG_USB_SUSB_HCD=y

CONFIG_USB_GADGET=y
CONFIG_USB_GADGET_VBUS_DRAW=2
CONFIG_USB_GADGET_STORAGE_NUM_BUFFERS=2

CONFIG_USB_LIBCOMPOSITE=y
CONFIG_USB_F_ACM=y
CONFIG_USB_U_SERIAL=y
CONFIG_USB_F_SERIAL=y
CONFIG_MODEM_SUPPORT=y
CONFIG_USB_G_ANDROID=y
CONFIG_USB_ANDROID_RNDIS_DWORD_ALIGNED=y

CONFIG_SOUND=y
CONFIG_SND=y
#CONFIG_SND_PCM_OSS is not set
CONFIG_HAVE_MEMBLOCK=y
CONFIG_ION_HI3XXX=y
CONFIG_ION=y
CONFIG_ION_HISI=y

CONFIG_IOMMU_API=y
CONFIG_IOMMU_SUPPORT=y
CONFIG_OF_IOMMU=y
CONFIG_HISI_IOMMU=y
CONFIG_HISI_IODOMAIN_API=y
CONFIG_HI3XXX_IOMMU=y
#CONFIG_HISI_IOMMU_TEST is not set

#mtd
CONFIG_MTD=y
CONFIG_BALONG_MTD=y
CONFIG_MTD_CMDLINE_PARTS=y
CONFIG_MTD_CHAR=y
CONFIG_HISI_NVE=y
CONFIG_MTD_BLKDEVS=y
CONFIG_MTD_BLOCK=y
CONFIG_MTD_BLOCK2MTD=y
CONFIG_MTD_OOPS=y
CONFIG_MTD_MAP_BANK_WIDTH_1=y
CONFIG_MTD_MAP_BANK_WIDTH_2=y
CONFIG_MTD_MAP_BANK_WIDTH_4=y
CONFIG_MTD_CFI_I1=y
CONFIG_MTD_CFI_I2=y

#
# Multimedia core support
#
CONFIG_MEDIA_SUPPORT=y
CONFIG_MEDIA_CAMERA_SUPPORT=y
CONFIG_MEDIA_CONTROLLER=y
CONFIG_VIDEO_DEV=y
CONFIG_VIDEO_V4L2_COMMON=y
# CONFIG_DVB_CORE is not set
CONFIG_VIDEO_MEDIA=y
#
# camera support
#
CONFIG_USE_CAMERA3_ARCH=y
CONFIG_HUAWEI_CAMERA_USE_EXTISP=y

#zram
CONFIG_SWAP=y
CONFIG_ZSMALLOC=y
CONFIG_ZRAM=y
#
#easy shell support
#
CONFIG_HISILICON_PLATFORM_HISI_EASYSHELL=y
CONFIG_HISI_LOWMEM_DBG=y

#
# efuse support
#
CONFIG_HI3XXX_EFUSE=y

#
# Logger extend configuration
#
CONFIG_LOGGER_EXTEND=y
CONFIG_LOG_SWITCH=y
CONFIG_LOG_EXCEPTION=y
CONFIG_LOG_JANK=y

#
# cmdline
#
CONFIG_HI3XXX_CMDLINE_PARSE=y

#
# watchdog support
#
CONFIG_WATCHDOG=y
CONFIG_ARM_SP805_WATCHDOG=y
CONFIG_HISI_EXTERN_WATCHDOG=y

#
#simcard hotplug
#
CONFIG_HI3XXX_SIM_HOTPLUG=y
CONFIG_HISILICON_PLATFORM_DDRC=y
CONFIG_HI3XXX_DDRC=y
CONFIG_HISILICON_PLATFORM_NOC=y
CONFIG_HISI_NOC=y
CONFIG_HISI_NOC_HI3635_PLATFORM=y
CONFIG_HISILICON_PLATFORM_KERNELDUMP=y
CONFIG_HISI_KERNELDUMP=y
CONFIG_HISI_MNTN=y
#
# HI3XXX hkadc support
#
CONFIG_HI3XXX_HKADC=y
# CONFIG_HI3XXX_HKADC_DEBUG is not set

#
# HI3XXX lpm3 debug support
#
CONFIG_HI3XXX_LPM3_DEBUG=y

#axierr
CONFIG_HISI_AXI=y

# enable device tree proc
CONFIG_BLK_DEV=y
CONFIG_BLK_DEV_LOOP=y
CONFIG_BLK_DEV_LOOP_MIN_COUNT=8
CONFIG_BLK_DEV_CRYPTOLOOP=y
CONFIG_PROC_DEVICETREE=y

#GPS
CONFIG_BCMGPS=y

#sensorhub
CONFIG_SENSORHUB_FEATURE_SUPPORT=y
CONFIG_INPUTHUB=y
CONFIG_IOM3_RECOVERY=y
#hall sensor
CONFIG_HUAWEI_HALL_INPUTHUB=y
CONFIG_HUAWEI_KSTATE=y

#selinux
#
CONFIG_SECURITY=y
CONFIG_SECURITY_SELINUX=y
CONFIG_SECURITY_NETWORK=y
CONFIG_AUDIT=y
CONFIG_HUAWEI_SELINUX_DSM=y
# trustedcore tzdriver
CONFIG_SECURE_EXTENSION=y
CONFIG_TZDRIVER=y
CONFIG_TEELOG=y
CONFIG_ATFDRIVER=y
#
# rdr
#
CONFIG_HISI_RDR=y
CONFIG_HISI_RDR_TEST=y
CONFIG_HIFI_RESET=y

#
#disable MISC_VIA to eliminate redefine SDIO_UL_SendPacket and SDIO_DL_RegDataCallback
#
CONFIG_MISC_VIA=n

#
# via 3rd modem
#
CONFIG_VIACBP82D_3RD_MODEM=y
CONFIG_VIACBP82D_3RD_MODEM_SPI=y


#
# hardware monitor support
#
CONFIG_HWMON=y
CONFIG_SENSORS_INA231=y

#manufacture
CONFIG_PROC_APP_INFO=y

CONFIG_SEATTLE=y
## power support
##
CONFIG_POWER_HUAWEI_S=y
CONFIG_BATTERY_HISI_COUL_S=y
CONFIG_BATTERY_HISI_HI6421V300_S=y
CONFIG_BQ_BCI_BATTERY_S=y
CONFIG_BATTERY_COULOMB_TEST_INTERFACE_S=y
CONFIG_BATTERY_HISI_COUL_TEST_S=y
CONFIG_HUAWEI_SMPL=y
CONFIG_HUAWEI_CPU_BUCK=y
CONFIG_HUAWEI_LP8754=y

CONFIG_HUAWEI_CHARGER=y
CONFIG_BQ2419X_CHARGER=y
CONFIG_BQ2429X_CHARGER=y
CONFIG_BQ25892_CHARGER=y

#bluetooth
#
CONFIG_RFKILL=y
CONFIG_BT_HCIUART=y
CONFIG_BT=y
CONFIG_BT_POWER=y
CONFIG_BT_SLEEP=y

# HID support
#
CONFIG_INPUT_UINPUT=y
CONFIG_UHID=y
CONFIG_HID=y
CONFIG_HID_GENERIC=y

# Special HID drivers
#
CONFIG_HID_A4TECH=y
CONFIG_HID_ACRUX=y
CONFIG_HID_ACRUX_FF=y
CONFIG_HID_APPLE=y
CONFIG_HID_APPLEIR=y
CONFIG_HID_AUREAL=y
CONFIG_HID_BELKIN=y
CONFIG_HID_CHERRY=y
CONFIG_HID_CHICONY=y
CONFIG_HID_PRODIKEYS=y
CONFIG_HID_CYPRESS=y
CONFIG_HID_DRAGONRISE=y
CONFIG_DRAGONRISE_FF=y
CONFIG_HID_EMS_FF=y
CONFIG_HID_ELECOM=y
CONFIG_HID_EZKEY=y
CONFIG_HID_HOLTEK=y
CONFIG_HOLTEK_FF=y
CONFIG_HID_KEYTOUCH=y
CONFIG_HID_KYE=y
CONFIG_HID_UCLOGIC=y
CONFIG_HID_WALTOP=y
CONFIG_HID_GYRATION=y
CONFIG_HID_ICADE=y
CONFIG_HID_TWINHAN=y
CONFIG_HID_KENSINGTON=y
CONFIG_HID_LCPOWER=y
CONFIG_HID_LENOVO_TPKBD=y
CONFIG_HID_LOGITECH=y
CONFIG_HID_LOGITECH_DJ=y
CONFIG_LOGITECH_FF=y
CONFIG_LOGIRUMBLEPAD2_FF=y
CONFIG_LOGIG940_FF=y
CONFIG_LOGIWHEELS_FF=y
CONFIG_HID_MAGICMOUSE=y
CONFIG_HID_MICROSOFT=y
CONFIG_HID_MONTEREY=y
CONFIG_HID_MULTITOUCH=y
CONFIG_HID_NTRIG=y
CONFIG_HID_ORTEK=y
CONFIG_HID_PANTHERLORD=y
CONFIG_PANTHERLORD_FF=y
CONFIG_HID_PETALYNX=y
CONFIG_HID_PICOLCD=y
CONFIG_HID_PICOLCD_FB=y
CONFIG_HID_PICOLCD_LEDS=y
CONFIG_HID_PRIMAX=y
CONFIG_HID_PS3REMOTE=y
CONFIG_HID_ROCCAT=y
CONFIG_HID_SAITEK=y
CONFIG_HID_SAMSUNG=y
CONFIG_HID_SONY=y
CONFIG_HID_SPEEDLINK=y
CONFIG_HID_STEELSERIES=y
CONFIG_HID_SUNPLUS=y
CONFIG_HID_GREENASIA=y
CONFIG_GREENASIA_FF=y
CONFIG_HID_SMARTJOYPLUS=y
CONFIG_SMARTJOYPLUS_FF=y
CONFIG_HID_TIVO=y
CONFIG_HID_TOPSEED=y
CONFIG_HID_THINGM=y
CONFIG_HID_THRUSTMASTER=y
CONFIG_THRUSTMASTER_FF=y
CONFIG_HID_WACOM=y
CONFIG_HID_WIIMOTE=y
CONFIG_HID_WIIMOTE_EXT=y
CONFIG_HID_ZEROPLUS=y
CONFIG_ZEROPLUS_FF=y
CONFIG_HID_ZYDACRON=y
CONFIG_HID_SENSOR_HUB=y


#antenna fpga
CONFIG_ANTENNA_FPGA=y

#
# Hisilicon mntn drivers
#
CONFIG_HISI_WATCHPOINT_CB=y


CONFIG_HISILICON_PLATFORM_MISC=y
CONFIG_HISILICON_PLATFORM_RSVMAP_CHECK=y

CONFIG_EXT4_FS_POSIX_ACL=y
CONFIG_FS_POSIX_ACL=y
CONFIG_MISC_FILESYSTEMS=y
CONFIG_CRAMFS=y
CONFIG_PSTORE=y
CONFIG_PSTORE_CONSOLE=y
CONFIG_PSTORE_RAM=y
CONFIG_PSTORE_FTRACE=y

CONFIG_TASKSTATS=y
CONFIG_TASK_XACCT=y
CONFIG_TASK_DELAY_ACCT=y
CONFIG_TASK_IO_ACCOUNTING=y

#enable goldeneye watchpoints
CONFIG_HUAWEI_GOLDENEYE=y

CONFIG_PRINTK_EXTENSION=y
CONFIG_DETECT_HUNG_TASK=y
CONFIG_HW_DETECT_HUNG_TASK=y
CONFIG_DEFAULT_HUNG_TASK_TIMEOUT=120
CONFIG_BOOTPARAM_HUNG_TASK_PANIC_VALUE=0


CONFIG_SCSI_LOWLEVEL=y 
CONFIG_RCU_CPU_STALL_INFO=y
CONFIG_MD=y 
CONFIG_BLK_DEV_DM=y 
CONFIG_DM_DEBUG=y 
CONFIG_DM_BUFIO=y
CONFIG_DM_CRYPT=y
CONFIG_DM_VERITY=y
CONFIG_FTRACE=y
CONFIG_BRANCH_PROFILE_NONE=y
CONFIG_DM_UEVENT=y 



CONFIG_CRYPTO=y
CONFIG_CRYPTO_CRC32C=y
CONFIG_CRYPTO_GHASH=y
# CONFIG_CRYPTO_MD4 is not set
CONFIG_CRYPTO_MD5=y
# CONFIG_CRYPTO_MICHAEL_MIC is not set
# CONFIG_CRYPTO_RMD128 is not set
# CONFIG_CRYPTO_RMD160 is not set
# CONFIG_CRYPTO_RMD256 is not set
# CONFIG_CRYPTO_RMD320 is not set
CONFIG_CRYPTO_SHA1=y
CONFIG_CRYPTO_SHA256=y
CONFIG_CRYPTO_SHA512=y
CONFIG_CRYPTO_SHA1_ARM=y
CONFIG_CRYPTO_USER_API=y
CONFIG_CRYPTO_USER_API_HASH=y
CONFIG_CRYPTO_USER_API_SKCIPHER=y
CONFIG_CRYPTO_ALGAPI=y
CONFIG_CRYPTO_ALGAPI2=y
CONFIG_ARM64_CRYPTO=y
CONFIG_CRYPTO_SHA1_ARM64_CE=y
CONFIG_CRYPTO_SHA2_ARM64_CE=y
CONFIG_CRYPTO_GHASH_ARM64_CE=y
CONFIG_CRYPTO_AES_ARM64_CE=y
CONFIG_CRYPTO_AES_ARM64_CE_CCM=y
CONFIG_CRYPTO_AES_ARM64_CE_BLK=y
CONFIG_CRYPTO_AES_ARM64_NEON_BLK=y
CONFIG_CRYPTO_AEAD=y
CONFIG_CRYPTO_AEAD2=y
CONFIG_CRYPTO_BLKCIPHER=y
CONFIG_CRYPTO_BLKCIPHER2=y
CONFIG_CRYPTO_HASH=y
CONFIG_CRYPTO_HASH2=y
CONFIG_CRYPTO_RNG=m
CONFIG_CRYPTO_RNG2=y
CONFIG_CRYPTO_PCOMP2=y
CONFIG_CRYPTO_MANAGER=y
CONFIG_CRYPTO_MANAGER2=y
CONFIG_CRYPTO_GF128MUL=y
CONFIG_CRYPTO_NULL=y
CONFIG_CRYPTO_WORKQUEUE=y
CONFIG_CRYPTO_CRYPTD=y
CONFIG_CRYPTO_AUTHENC=y
CONFIG_CRYPTO_TEST=m
CONFIG_CRYPTO_CCM=y
CONFIG_CRYPTO_GCM=y
CONFIG_CRYPTO_SEQIV=y
CONFIG_CRYPTO_CBC=y
CONFIG_CRYPTO_CTR=y
CONFIG_CRYPTO_CTS=y
CONFIG_CRYPTO_ECB=y
CONFIG_CRYPTO_XTS=y
CONFIG_CRYPTO_HMAC=y
CONFIG_CRYPTO_XCBC=y
CONFIG_CRYPTO_AES=y
CONFIG_CRYPTO_AES_ARM=y
CONFIG_CRYPTO_DES=y
CONFIG_CRYPTO_ANSI_CPRNG=m
CONFIG_CRYPTO_TWOFISH=y
CONFIG_HW_SYSTEM_WR_PROTECT=y
# bastet drivers support
CONFIG_HUAWEI_BASTET=y
# wifipro tcp monitor support
CONFIG_HW_WIFIPRO=y
# note: depends on CONFIG_HW_WIFIPRO
CONFIG_HW_WIFIPRO_PROC=y

CONFIG_SRECORDER=y
CONFIG_SRECORDER_LOG_BUF_LEN=0x40000
CONFIG_SRECORDER_TEMPBUF_ADDR_FROM_PHYS_OFFSET=0x8000000
CONFIG_KERNEL_LOAD_PHYS_OFFSET=0x600000
CONFIG_SRECORDER_SPECIAL_MEM_ADDR_FROM_PHYS_OFFSET=0x6000000
CONFIG_SRECORDER_DUMP_LOG_TO_STORAGECARD=y
CONFIG_DUMP_CRASH_TIME=y
CONFIG_DUMP_DMESG=y
CONFIG_DUMP_SYS_INFO=y
CONFIG_DUMP_ALLCPU_STACK=y
CONFIG_DUMP_ALLPS_INFO=y
CONFIG_DUMP_CURRENT_PS_BACKTRACE=y
CONFIG_DUMP_SLAB_INFO=y
# CONFIG_DUMP_MODEM_LOG is not set
# CONFIG_DUMP_MODEM_LOG_BY_FIQ is not set
# DUMP_MODEM_LOG_DELAY_MAX_MS is not set
# CPU_FREQ_DEFAULT_VALUE is not set
CONFIG_POWERCOLLAPSE=y
# CONFIG_DUMP_LOGCAT is not set
# CONFIG_DEBUG_SRECORDER is not set
CONFIG_SRECORDER_VERSION="0.0.0.1"
CONFIG_HISI_DDR_DEBUG=y

# CONFIG_PANIC_ON_DATA_CORRUPTION is not set
# CONFIG_FORCE_PAGES is not set
# CONFIG_FREE_PAGES_RDONLY is not set
# CONFIG_DEBUG_PAGEALLOC is not set
# CONFIG_ARM64_PTDUMP is not set

# CONFIG_SLUB_DEBUG_ON is not set
CONFIG_DEBUG_RODATA=y
CONFIG_HUAWEI_MSG_POLICY=y

CONFIG_PROC_POSTFSDATA=y

CONFIG_UID_CPUTIME=y

CONFIG_FEATURE_HUAWEI_EMERGENCY_DATA=y

CONFIG_HUAWEI_NFF=y

CONFIG_SECCOMP=y
CONFIG_SECCOMP_FILTER=y
CONFIG_SCHED_HMP_BOOST=y

#perfhub
CONFIG_HISI_PERFHUB=y

CONFIG_CGROUP_PIDS=y
CONFIG_CGROUP_PIDS_NOTIFY_USER=y

CONFIG_ERP_STANDARD_ENABLED=y
```
