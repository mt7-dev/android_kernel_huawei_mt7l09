## drivers/hisi/modem_hi3630/drv/balong_fs/Kconfig
```kconfig
#
# balong early mount fs 
#

comment "balong early mount fs"

config BALONG_EARLY_FS
	tristate "balong early mount fs"
	default n
	help
	  balong early mount fs
	  
config BALONG_EARLY_FS_TEST
	tristate "balong early mount fs test"
	default n
	help
	  balong early mount fs test
```

## drivers/hisi/modem_hi3630/drv/balong_timer/Kconfig
```kconfig
#
# timer driver
#
comment "timer driver"

config HARD_TIMER
	tristate "hard timer"
	default n
	help
	  hard timer interface

config HARD_TIMER_TEST
	tristate "hard timer test"
	default n
	help
	  hard timer test
	  
config TIMER_ADP
	tristate "timer adaption"
	default n
	help
	  timer adaption for v7r1
	  
config SOFT_TIMER
	tristate "soft timer"
	default n
	help
	  soft timer interface
	  
config SOFT_TIMER_TEST
	tristate "soft timer test"
	default n
	help
	  soft timer test
	  
	  
```

## drivers/hisi/modem_hi3630/drv/dsp/Kconfig
```kconfig
#
# dsp image load
#

comment "dsp image load driver"

config DSP_BALONG
	tristate "dsp image load"
	default n
	help
	  dsp image load driver
```

## drivers/hisi/modem_hi3630/drv/gpio/Kconfig
```kconfig
#
# GPIO infrastructure and drivers
#

config GPIO_BALONG
	tristate "Hisi Balong GPIO support"
	depends on GPIOLIB
	help
	  Support for the Hisi balongv7r2 SoC GPIOs.
	  
config GPIO_EXPANDER_BALONG
	tristate "Hisi Balong GPIO I2C expander"
	# depends on nothing, just a device register.
	help
	  Support for the Hisi balong I2C To GPIO trans.
```

## drivers/hisi/modem_hi3630/drv/ios/Kconfig
```kconfig
#
# IOS infrastructure and drivers
#

config IOS_BALONG
	tristate "Hisi Balong IO Pad support"
	help
	  Support for the Hisi balongv7r2 SoC IO PAD.
```

## drivers/hisi/modem_hi3630/drv/rtc/Kconfig
```kconfig
if RTC_CLASS
config BALONG_RTC
	tristate "balong RTC support"
	depends on ICC_BALONG
	default n
	help
	  This is a driver for the balong on-chip Counter0 (Time-Of-Year
	  counter) to be used as a RTC.

	  This driver can also be built as a module. If so, the module
	  will be called rtc-ls1x.
config BALONG_RTC_TEST
	tristate "rtc test"
	depends on BALONG_RTC
	default n
	help
	  rtc test
config HI6551_RTC
	tristate "balong RTC support"
	depends on ICC_BALONG
	default n
	help
	  This is a driver for the balong on-chip Counter0 (Time-Of-Year
	  counter) to be used as a RTC.

	  This driver can also be built as a module. If so, the module
	  will be called rtc-ls1x.
endif # RTC_CLASS
```

## drivers/hisi/modem_hi3630/drv/sec/Kconfig
```kconfig
#
# image check
#

comment "image check driver"

config SEC_CHECK
	tristate "image check driver"
	default n
	help
	  image check driver
```

## drivers/hisi/modem_hi3xxx/drv/Kconfig
```kconfig
menu "Modem(HI6930) Drivers"

source "drivers/hisi/modem_hi3630/drv/icc/Kconfig"
source "drivers/hisi/modem_hi3630/drv/ipc/Kconfig"
source "drivers/hisi/modem_hi3630/drv/adp/Kconfig"
source "drivers/hisi/modem_hi3630/drv/sync/Kconfig"
source "drivers/hisi/modem_hi3630/drv/dsp/Kconfig"
source "drivers/hisi/modem_hi3630/drv/hkadc/Kconfig"
source "drivers/hisi/modem_hi3630/drv/hwadp/Kconfig"
source "drivers/hisi/modem_hi3630/drv/loadm/Kconfig"
source "drivers/hisi/modem_hi3630/drv/balong_fs/Kconfig"
source "drivers/hisi/modem_hi3630/drv/onoff/Kconfig"
source "drivers/hisi/modem_hi3630/drv/sec/Kconfig"
source "drivers/hisi/modem_hi3630/drv/rfile/Kconfig"
source "drivers/hisi/modem_hi3630/drv/rtc/Kconfig"
source "drivers/hisi/modem_hi3630/drv/cshell/Kconfig"
source "drivers/hisi/modem_hi3630/drv/mem/Kconfig"
source "drivers/hisi/modem_hi3630/drv/udi/Kconfig"
source "drivers/hisi/modem_hi3630/drv/gpio/Kconfig"
source "drivers/hisi/modem_hi3630/drv/keyboard/Kconfig"
source "drivers/hisi/modem_hi3630/drv/balong_timer/Kconfig"
source "drivers/hisi/modem_hi3630/drv/cipher/Kconfig"
source "drivers/hisi/modem_hi3630/drv/nvim/Kconfig"
source "drivers/hisi/modem_hi3630/drv/ios/Kconfig"
source "drivers/hisi/modem_hi3630/drv/efuse/Kconfig"
source "drivers/hisi/modem_hi3630/drv/balong_oam_ps/Kconfig"
source "drivers/hisi/modem_hi3630/drv/reset/Kconfig"
source "drivers/hisi/modem_hi3630/drv/reset_hifi/Kconfig"
source "drivers/hisi/modem_hi3630/drv/lowpower_mntn/Kconfig"
source "drivers/hisi/modem_hi3630/drv/temperature/Kconfig"
source "drivers/hisi/modem_hi3630/drv/misc/Kconfig"
endmenu
```

## drivers/media/huawei/Kconfig
```kconfig
comment "Huawei Multimedia"

menuconfig HUAWEI_CAMERA
    bool "Huawei camera and video capture support"
    default y
    select ION
    select MEDIA_CONTROLLER 
    select VIDEOBUF2_CORE
    select VIDEO_V4L2
    help
        Say Y here to enable selecting the video adapters for
        Huawei camera
	
menuconfig ION_FOR_EMULATOR
     bool "Huawei camera and video support for emulator"	
     default n
     select ION
     help
        Say Y here to enable selecting the video adapters for
        Huawei camera emulator
	
if HUAWEI_CAMERA
source "drivers/media/huawei/camera/Kconfig"
endif
```

## drivers/media/huawei/camera/sensor/Kconfig
```kconfig
comment "Huawei Sensor"

config HUAWEI_CAMERA_USE_FAKE_SENSOR
	bool "fake sensor for emulator"
    default n
	depends on HUAWEI_CAMERA

config HUAWEI_CAMERA_USE_IMX135
	bool "imx135"
    default n
	depends on HUAWEI_CAMERA

config HUAWEI_CAMERA_USE_IMX214
	bool "imx214"
    default y
	depends on HUAWEI_CAMERA

config HUAWEI_CAMERA_USE_OV5648
	bool "ov5648"
    default y
	depends on HUAWEI_CAMERA

config HUAWEI_CAMERA_USE_IMX179_REAR
	bool "imx179_rear"
    default y
	depends on HUAWEI_CAMERA

config HUAWEI_CAMERA_USE_IMX179_FRONT
	bool "imx179_front"
    default y
	depends on HUAWEI_CAMERA

config HUAWEI_CAMERA_USE_OV8865_REAR
	bool "ov8865_rear"
    default y
	depends on HUAWEI_CAMERA
```

## drivers/modem/Kconfig
```kconfig
menu "Modem(HI6930) Drivers"

source "drivers/modem/icc/Kconfig"
source "drivers/modem/ipc/Kconfig"
source "drivers/modem/adp/Kconfig"
source "drivers/modem/sync/Kconfig"
source "drivers/modem/dsp/Kconfig"
source "drivers/modem/hkadc/Kconfig"
source "drivers/modem/hwadp/Kconfig"
source "drivers/modem/loadm/Kconfig"
source "drivers/modem/balong_fs/Kconfig"
source "drivers/modem/onoff/Kconfig"
source "drivers/modem/sec/Kconfig"
source "drivers/modem/rfile/Kconfig"
source "drivers/modem/rtc/Kconfig"
source "drivers/modem/cshell/Kconfig"
source "drivers/modem/mem/Kconfig"
source "drivers/modem/udi/Kconfig"
source "drivers/modem/gpio/Kconfig"
source "drivers/modem/keyboard/Kconfig"
source "drivers/modem/balong_timer/Kconfig"
source "drivers/modem/cipher/Kconfig"
source "drivers/modem/nvim/Kconfig"
source "drivers/modem/ios/Kconfig"
source "drivers/modem/efuse/Kconfig"
source "drivers/modem/balong_oam_ps/Kconfig"
source "drivers/modem/reset/Kconfig"
source "drivers/modem/reset_hifi/Kconfig"
source "drivers/modem/lowpower_mntn/Kconfig"
source "drivers/modem/temperature/Kconfig"
endmenu
```

## drivers/modem/adp/Kconfig
```kconfig
config CONFIG_IPC_ADP
	tristate "ipc adaption"
	depends on IPC_DRIVER
	default n
	help
	  ipc adaption

config CONFIG_ICC_ADP
	tristate "icc adaption"
	depends on ICC_BALONG
	default n
	help
	  icc adaption


config CONFIG_ADP_GIC
	tristate "gic adp"
	default n
	help
	  gic adaption
	  
	  
	  
config CONFIG_ANTEN_ADP
	tristate "anten adaption"
	default n
	help
	  anten adaption
	  
config CONFIG_NVIM_ADP
	tristate "nvim adaption"
	default n
	help
	  nvim adaption	  
```

## drivers/modem/cipher/Kconfig
```kconfig
#
# Balong cipher-kdf driver configuration
#

comment "balong cipher-kdf driver"

config KDF_HASH
	tristate "cipher-kdf"
	help
		cipher-kdf driver
```

## drivers/modem/cshell/Kconfig
```kconfig
#
# cshell driver
#

comment "cshell driver"

config HI6930_CSHELL
	tristate "support cshell"
	help
	  cshell driver
```

## drivers/modem/lowpower_mntn/Kconfig
```kconfig
#
# multicore communication driver
#

comment "multicore communication driver"

config PWC_MNTN_ACORE
	tristate "support lowpower mntn"
	default n
	help
	  lowpower mntn balong
```

## drivers/modem/onoff/Kconfig
```kconfig
#
# balong onoff management
#

comment "balong onoff management"

config BALONG_ONOFF
	tristate "balong onoff management"
	default n
	help
	  balong onoff management

config BALONG_MODEM_BOOT
	tristate "the interface of balong modem state"
	default n
	help
	  balong modem state
```

## drivers/modem/rfile/Kconfig
```kconfig
#
# acore image load
#s

comment "acore image load driver"

config RFILE_SUPPORT
	tristate "support rfile"
	default n
	help
	  RFILE driver
	  
config RFILE_TEST
	tristate "rfile test"
	default n
	help
	  RFILE test
```

## drivers/vendor/hisi/config/product/hi3630_udp/os/acore/hi6930_modem_defconfig
```kconfig
# balong modem
CONFIG_HISI_BALONG_MODEM=y

CONFIG_IPC_DRIVER=y
CONFIG_IPC_TEST=y
CONFIG_IPC_ADP=y


CONFIG_ICC_BALONG=y
CONFIG_ICC_BALONG_TEST=n

CONFIG_IPF_DRIVER=y
CONFIG_IPF_TEST=y

#DSP
CONFIG_DSP_BALONG=y

#HKADC
CONFIG_HKADC_BALONG=n

#nvim
CONFIG_NVIM=y
CONFIG_NVIM_TEST=y

#Loadm
CONFIG_IMAGE_LOAD=y

#OnOff
CONFIG_BALONG_ONOFF=y
CONFIG_BALONG_MODEM_BOOT=y

#Balong FS
CONFIG_BALONG_EARLY_FS = n

CONFIG_ADP_GIC=y
# sync
CONFIG_SYNC_BALONG=y
CONFIG_HW_IP_BASE_ADDR=y

#rfile
CONFIG_RFILE_SUPPORT=y

/*RTC*/
CONFIG_BALONG_RTC=n
CONFIG_RTC_CLASS=y
CONFIG_RTC_BALONG_TEST=n
/*MEM*/
CONFIG_MEM_BALONG=y

#dual modem
CONFIG_DUAL_MODEM=n

/*timer*/
CONFIG_HARD_TIMER=y
CONFIG_SOFT_TIMER=y

/* OM Dump */
CONFIG_HISI_RDR=y
# gpio
CONFIG_GPIO_BALONG=n

# keyboard
CONFIG_BALONG_KEYBOARD_GPIO=n

CONFIG_UDI_SUPPORT=y
CONFIG_BALONG_OAM_PS=y
CONFIG_TEMPERATURE_SYS_BALONG=n
CONFIG_FRAME_WARN=2048

CONFIG_BALONG_MODEM_RESET=y
CONFIG_BALONG_MODEM_RESET_TEST=y
CONFIG_BALONG_MODEM_POWER_MANAGE=n

CONFIG_HIFI_RESET=y

#lowpower mntn
CONFIG_PWC_MNTN_ACORE=y
```

## drivers/vendor/hisi/modem/drv/acore/kernel/arch/arm/mach-hi6930/Kconfig
```kconfig
if ARCH_HI6930

menu "HI6930 Soc Type"

config  ARCH_TEST
	bool "hi6930 Test"
	select CPU_V7
	select ARM_GIC
	help
	    support for hisilicon hi6930 Test platform

config  ARCH_P531
	bool "hi6930 P531"
	select CPU_V7
	select ARM_GIC
	select MIGHT_HAVE_PCI
	select ARCH_SUPPORTS_MSI
	select MIGHT_HAVE_CACHE_L2X0
	help
	    support for hisilicon hi6930 P531 platform

config  ARCH_V7R2
	bool "hi6930 v7r2"
	select CPU_V7
	select ARM_GIC
	select MIGHT_HAVE_PCI
	select ARCH_SUPPORTS_MSI
	select MIGHT_HAVE_CACHE_L2X0
	help
	    support for hisilicon hi6930 v7r2 platform

config  ARCH_V711
	bool "hi6930 v711"
	select CPU_V7
	select ARM_GIC
	select MIGHT_HAVE_PCI
	select ARCH_SUPPORTS_MSI
	help
	    support for hisilicon hi6930 v711 platform
endmenu

config BALONG_EASY_SHELL
	bool "balong easy shell(ecall) support"
	default y
	help
	Support for the Hisilicon Balong easy shell.

config BALONG_PCIE_RC
	bool "balong pcie rc mode support"
	default n
	help
	Support for the Hisilicon Balong Pcie RC Mode.

config BALONG_PCIE_EP
	bool "balong pcie ep mode support"
	default n
	help
	Support for the Hisilicon Balong Pcie EP Mode.

config HAVE_CPU_IDLE
    bool "balong cpu idle support"
    select CPU_IDLE
    default n
	help
	   support for the Hisilicon Balong cpu idle.

config BSP_TEST_ACORE
	bool "hi6930 test "
	default n
	help
	Support for hisilicon hi6930 test.	


config BALONG_PM_SUSPEND
	bool "balong pm suspend"
	select SUSPEND
	select ARCH_SUSPEND_POSSIBLE
	select PM
	select PM_SLEEP
	select CPU_V7
	default n
	help
	support for pm suspend

endif
```

## drivers/vendor/hisi/modem/drv/acore/kernel/drivers/balong_pciedt/Kconfig
```kconfig
#
# pcie docking test
#

comment "balong pcie docking test"

config BALONG_PCIE_DOCKING_TEST
	tristate "balong pcie docking test"
	default n
	help
	  balong pcie docking test 
```

## drivers/vendor/hisi/modem/drv/acore/kernel/drivers/busstress/Kconfig
```kconfig
#
# Balong busstress test configuration
#

comment "balong busstress test"

config BUSSTRESS
	tristate "busstress"
	help
	  BUSSTRESS test
	  
```

## drivers/vendor/hisi/modem/drv/acore/kernel/drivers/edma/Kconfig
```kconfig
#
# Balong EDMA engine configuration
#

comment "balong edma driver"

config EDMA_SUPPORT
	tristate "support edma"
	default n
	help
	  EDMA driver
	  
config EDMA_TEST
	tristate "edma test"
	depends on EDMA_SUPPORT
	default n
	help
	  EDMA test
```
