## arch/arm64/configs/hisi_3635fpga_defconfig
```kconfig
CONFIG_ARCH_HI3XXX=y
CONFIG_HISI_3635_FPGA=y
CONFIG_HISILICON_PLATFORM=y
CONFIG_ARCH_KIRIN=y
CONFIG_EXPERIMENTAL=y
# CONFIG_LOCALVERSION_AUTO is not set
# CONFIG_SWAP is not set
CONFIG_SYSVIPC=y
CONFIG_POSIX_MQUEUE=y
CONFIG_BSD_PROCESS_ACCT=y
CONFIG_BSD_PROCESS_ACCT_V3=y
CONFIG_NO_HZ=y
CONFIG_HIGH_RES_TIMERS=y
CONFIG_IKCONFIG=y
CONFIG_IKCONFIG_PROC=y
CONFIG_LOG_BUF_SHIFT=14
# CONFIG_UTS_NS is not set
# CONFIG_IPC_NS is not set
# CONFIG_PID_NS is not set
# CONFIG_NET_NS is not set
CONFIG_BLK_DEV_INITRD=y
CONFIG_KALLSYMS_ALL=y
# CONFIG_COMPAT_BRK is not set
CONFIG_PROFILING=y
CONFIG_MODULES=y
CONFIG_MODULE_UNLOAD=y
# CONFIG_BLK_DEV_BSG is not set
# CONFIG_IOSCHED_DEADLINE is not set
CONFIG_SMP=y
CONFIG_NR_CPUS=3
CONFIG_PREEMPT_VOLUNTARY=y
CONFIG_CMDLINE="console=ttyAMA0"
# CONFIG_CORE_DUMP_DEFAULT_ELF_HEADERS is not set
CONFIG_COMPAT=y
CONFIG_NET=y
CONFIG_PACKET=y
CONFIG_UNIX=y
CONFIG_INET=y
CONFIG_IP_PNP=y
CONFIG_IP_PNP_DHCP=y
CONFIG_IP_PNP_BOOTP=y
# CONFIG_INET_LRO is not set
# CONFIG_IPV6 is not set
# CONFIG_WIRELESS is not set
CONFIG_UEVENT_HELPER_PATH="/sbin/hotplug"
CONFIG_DEVTMPFS=y
# CONFIG_BLK_DEV is not set
CONFIG_SCSI=y
# CONFIG_SCSI_PROC_FS is not set
CONFIG_BLK_DEV_SD=y
# CONFIG_SCSI_LOWLEVEL is not set
CONFIG_NETDEVICES=y
# CONFIG_WLAN is not set
# CONFIG_INPUT_EVDEV is not set
# CONFIG_SERIO_I8042 is not set
# CONFIG_SERIO_SERPORT is not set
CONFIG_LEGACY_PTY_COUNT=16
CONFIG_SERIAL_AMBA_PL011=y
CONFIG_SERIAL_AMBA_PL011_CONSOLE=y
# CONFIG_HW_RANDOM is not set
# CONFIG_HWMON is not set

#
## Power management options
#
CONFIG_SUSPEND=y
CONFIG_SUSPEND_FREEZER=y
CONFIG_HAS_WAKELOCK=y
CONFIG_WAKELOCK=y
CONFIG_PM_SLEEP=y
CONFIG_PM_SLEEP_SMP=y
CONFIG_PM_AUTOSLEEP=y
CONFIG_PM_WAKELOCKS=y
CONFIG_PM_WAKELOCKS_LIMIT=100
CONFIG_PM_WAKELOCKS_GC=y
CONFIG_PM_RUNTIME=y
CONFIG_PM=y
CONFIG_HI3XXX_SR=y
CONFIG_HISI_SR_DEBUG=y
CONFIG_HISI_SR_DEBUG_SLEEP=y

CONFIG_SYNC=y
CONFIG_SW_SYNC=y
CONFIG_SW_SYNC_USER=y
#
# Graphics support
#
CONFIG_FB=y
# CONFIG_FB_FAKE is not set
# CONFIG_FB_VIRTUAL is not set
# CONFIG_FB_3630 is not set
CONFIG_FB_3635=y
# CONFIG_FB_3650 is not set
# CONFIG_FASTBOOT_DISP_ENABLE is not set

# CONFIG_BACKLIGHT_LCD_SUPPORT is not set
# CONFIG_BACKLIGHT_CLASS_DEVICE is not set

CONFIG_LCD_CLASS_DEVICE=y
CONFIG_NEW_LEDS=y
CONFIG_LEDS_CLASS=y
CONFIG_LEDS_TRIGGERS=y
CONFIG_LEDS_TRIGGER_TIMER=y

# CONFIG_VGA_CONSOLE is not set
CONFIG_FRAMEBUFFER_CONSOLE=y
CONFIG_LOGO=y
# CONFIG_LOGO_LINUX_MONO is not set
# CONFIG_LOGO_LINUX_VGA16 is not set

# jpeg support drivers
CONFIG_JPEG_CODEC=y

# vcodec support drivers
#
CONFIG_IMAGINATION_VCODEC=y

CONFIG_IMG_DEC=y
CONFIG_IMG_VIDEO=y
sdg
#
# img encode support
#
CONFIG_IMG_ENC=y
CONFIG_HIK3_VPP=y

CONFIG_BLOCK=y
CONFIG_HAS_IOMEM=y

CONFIG_MMC=y
CONFIG_MMC_DEBUG=y
CONFIG_MMC_ARMMMCI=y
CONFIG_MMC_UNSAFE_RESUME=y
# MMC/SD/SDIO Card Drivers
CONFIG_MMC_BLOCK=y
CONFIG_MMC_BLOCK_MINORS=40
CONFIG_MMC_BLOCK_BOUNCE=y
# MMC/SD/SDIO Host Controller Drivers
CONFIG_MMC_DW=y
CONFIG_MMC_DW_IDMAC=y
CONFIG_MMC_DW_PLTFM=y
CONFIG_MMC_DW_HI3XXX=y
CONFIG_EXT2_FS=y
CONFIG_EXT3_FS=y
CONFIG_EXT4_FS=y
# CONFIG_EXT3_DEFAULTS_TO_ORDERED is not set
# CONFIG_EXT3_FS_XATTR is not set
CONFIG_FUSE_FS=y
CONFIG_CUSE=y
CONFIG_VFAT_FS=y
CONFIG_TMPFS=y
CONFIG_SDCARD_FS=y
# CONFIG_MISC_FILESYSTEMS is not set
CONFIG_NFS_FS=y
CONFIG_ROOT_NFS=y
CONFIG_NLS_CODEPAGE_437=y
CONFIG_NLS_ISO8859_1=y
CONFIG_MAGIC_SYSRQ=y
CONFIG_DEBUG_FS=y
CONFIG_DEBUG_KERNEL=y
# CONFIG_SCHED_DEBUG is not set
CONFIG_DEBUG_INFO=y
# CONFIG_FTRACE is not set
CONFIG_ATOMIC64_SELFTEST=y
CONFIG_PRINTK_TIME=y
CONFIG_HISI_TIME=y

#
# Android Base Configure
#
#  KEEP ALPHABETICALLY SORTED
CONFIG_ANDROID=y
CONFIG_ANDROID_BINDER_IPC=y
# CONFIG_ANDROID_INTF_ALARM_DEV is not set
CONFIG_ANDROID_LOGGER=y
CONFIG_ANDROID_LOW_MEMORY_KILLER=y
CONFIG_ASHMEM=y
CONFIG_BLK_DEV_DM=y
CONFIG_BLK_DEV_INITRD=y
CONFIG_CGROUPS=y
CONFIG_CGROUP_CPUACCT=y
CONFIG_CGROUP_DEBUG=y
CONFIG_CGROUP_FREEZER=y
CONFIG_CGROUP_SCHED=y
CONFIG_DM_CRYPT=y
CONFIG_EMBEDDED=y
CONFIG_EXPERIMENTAL=y
CONFIG_HIGH_RES_TIMERS=y

#
#spi
#
CONFIG_SPI=y
CONFIG_SPI_MASTER=y
CONFIG_SPI_DEBUG=y
CONFIG_SPI_PL022=y
CONFIG_SPI_SPIDEV=y

CONFIG_INET6_ESP=y
CONFIG_INET6_IPCOMP=y
CONFIG_INET=y
CONFIG_INET_ESP=y
CONFIG_IP6_NF_FILTER=y
CONFIG_IP6_NF_IPTABLES=y
CONFIG_IP6_NF_MANGLE=y
CONFIG_IP6_NF_RAW=y
CONFIG_IP6_NF_TARGET_REJECT=y
CONFIG_IP6_NF_TARGET_REJECT_SKERR=y
CONFIG_IPV6_MIP6=y
CONFIG_IPV6_MULTIPLE_TABLES=y
CONFIG_IPV6_OPTIMISTIC_DAD=y
CONFIG_IPV6_PRIVACY=y
CONFIG_IPV6_ROUTER_PREF=y
CONFIG_IP_ADVANCED_ROUTER=y
CONFIG_IP_MULTIPLE_TABLES=y
CONFIG_IP_NF_ARPFILTER=y
CONFIG_IP_NF_ARPTABLES=y
CONFIG_IP_NF_ARP_MANGLE=y
CONFIG_IP_NF_FILTER=y
CONFIG_IP_NF_IPTABLES=y
CONFIG_IP_NF_MANGLE=y
CONFIG_IP_NF_MATCH_AH=y
CONFIG_IP_NF_MATCH_ECN=y
CONFIG_IP_NF_MATCH_TTL=y
CONFIG_IP_NF_RAW=y
CONFIG_IP_NF_TARGET_MASQUERADE=y
CONFIG_IP_NF_TARGET_NETMAP=y
CONFIG_IP_NF_TARGET_REDIRECT=y
CONFIG_IP_NF_TARGET_REJECT=y
CONFIG_IP_NF_TARGET_REJECT_SKERR=y
CONFIG_NET=y
CONFIG_NETDEVICES=y
CONFIG_NETFILTER=y
CONFIG_NETFILTER_TPROXY=y
CONFIG_NETFILTER_XT_MATCH_COMMENT=y
CONFIG_NETFILTER_XT_MATCH_CONNLIMIT=y
CONFIG_NETFILTER_XT_MATCH_CONNMARK=y
CONFIG_NETFILTER_XT_MATCH_CONNTRACK=y
CONFIG_NETFILTER_XT_MATCH_HASHLIMIT=y
CONFIG_NETFILTER_XT_MATCH_HELPER=y
CONFIG_NETFILTER_XT_MATCH_IPRANGE=y
CONFIG_NETFILTER_XT_MATCH_LENGTH=y
CONFIG_NETFILTER_XT_MATCH_LIMIT=y
CONFIG_NETFILTER_XT_MATCH_MAC=y
CONFIG_NETFILTER_XT_MATCH_MARK=y
CONFIG_NETFILTER_XT_MATCH_PKTTYPE=y
CONFIG_NETFILTER_XT_MATCH_POLICY=y
# CONFIG_NETFILTER_XT_MATCH_QTAGUID is not set
CONFIG_NETFILTER_XT_MATCH_QUOTA2=y
CONFIG_NETFILTER_XT_MATCH_QUOTA2_LOG=y
CONFIG_NETFILTER_XT_MATCH_QUOTA=y
CONFIG_NETFILTER_XT_MATCH_SOCKET=y
CONFIG_NETFILTER_XT_MATCH_STATE=y
CONFIG_NETFILTER_XT_MATCH_STATISTIC=y
CONFIG_NETFILTER_XT_MATCH_STRING=y
CONFIG_NETFILTER_XT_MATCH_TIME=y
CONFIG_NETFILTER_XT_MATCH_U32=y
CONFIG_NETFILTER_XT_TARGET_CLASSIFY=y
CONFIG_NETFILTER_XT_TARGET_CONNMARK=y
CONFIG_NETFILTER_XT_TARGET_MARK=y
CONFIG_NETFILTER_XT_TARGET_NFLOG=y
CONFIG_NETFILTER_XT_TARGET_NFQUEUE=y
CONFIG_NETFILTER_XT_TARGET_TCPMSS=y
CONFIG_NETFILTER_XT_TARGET_TPROXY=y
CONFIG_NETFILTER_XT_TARGET_TRACE=y
CONFIG_NET_CLS_ACT=y
CONFIG_NET_CLS_U32=y
CONFIG_NET_EMATCH=y
CONFIG_NET_EMATCH_U32=y
CONFIG_NET_KEY=y
CONFIG_NET_SCHED=y
CONFIG_NET_SCH_HTB=y
CONFIG_NF_CONNTRACK=y
CONFIG_NF_CONNTRACK_AMANDA=y
CONFIG_NF_CONNTRACK_EVENTS=y
CONFIG_NF_CONNTRACK_FTP=y
CONFIG_NF_CONNTRACK_H323=y
CONFIG_NF_CONNTRACK_IPV4=y
CONFIG_NF_CONNTRACK_IPV6=y
CONFIG_NF_CONNTRACK_IRC=y
CONFIG_NF_CONNTRACK_NETBIOS_NS=y
CONFIG_NF_CONNTRACK_PPTP=y
CONFIG_NF_CONNTRACK_SANE=y
CONFIG_NF_CONNTRACK_TFTP=y
CONFIG_NF_CT_NETLINK=y
CONFIG_NF_CT_PROTO_DCCP=y
CONFIG_NF_CT_PROTO_SCTP=y
CONFIG_NF_CT_PROTO_UDPLITE=y
CONFIG_NF_NAT=y
CONFIG_NO_HZ=y
CONFIG_PACKET=y
CONFIG_PM_AUTOSLEEP=y
CONFIG_PM_WAKELOCKS=y
CONFIG_PPP=y
CONFIG_PPPOLAC=y
CONFIG_PPPOPNS=y
CONFIG_PPP_BSDCOMP=y
CONFIG_PPP_DEFLATE=y
CONFIG_PPP_MPPE=y
CONFIG_PREEMPT=y
CONFIG_RESOURCE_COUNTERS=y
CONFIG_RT_GROUP_SCHED=y
CONFIG_STAGING=y
CONFIG_SWITCH=y
CONFIG_SYNC=y
CONFIG_SYSVIPC=y
CONFIG_TUN=y
CONFIG_UNIX=y
CONFIG_XFRM_USER=y
CONFIG_SWITCH_FSA9685=y
CONFIG_SWITCH_USB_CLS=y
CONFIG_FSA9685_DEBUG_FS=y
#
#ipc support
#
CONFIG_HI3XXX_MAILBOX=y
CONFIG_HISI_MAILBOX_DEBUGFS=y
CONFIG_HISI_MAILBOX_PERFORMANCE_DEBUG=y
CONFIG_HI3XXX_RPROC=y
CONFIG_HISI_RPROC_DEBUGFS=y

#hifi_mailbox
CONFIG_HIFI_MAILBOX=y
CONFIG_HIFI_IPC=y

CONFIG_MFD_HI6402_IRQ=y
CONFIG_MFD_HI3630_ASP_IRQ=y
CONFIG_SND_SOC=y
CONFIG_SND_SOC_PCM_HI3630=y
CONFIG_SND_SOC_HI6402=y
CONFIG_HI6402_MBHC=y
CONFIG_HI6402_HIFI_MISC=y
CONFIG_SND_HI3630_HI6402=y
# CONFIG_MFD_HI6401_IRQ is not set
# CONFIG_SND_SOC_HI6401 is not set
# CONFIG_SND_HI3630_HI6401 is not set
# CONFIG_SND_SOC_PCM_HI6210 is not set

#hifi dsp
CONFIG_HISILICON_PLATFORM_HIFI_DSP=y

# CONFIG_SND_HIFI_LPP_HI6XXX is not set
# CONFIG_SND_HIFI_LOAD_HI6XXX is not set
# CONFIG_SND_HIFI_SEC_LOAD_HI6XXX is not set
#
#irq affinity support
#
CONFIG_HI3XXX_IRQ_AFFINITY=y
CONFIG_HI3XXX_IRQ_AFFINITY_DEBUGFS=y

#
# pm opp support
#
CONFIG_PM_OPP=y

#
# devfreq support
#
CONFIG_PM_DEVFREQ=y

#
# DDR devfreq support
#
CONFIG_HI3XXX_DDR_DEVFREQ=y
CONFIG_HI3XXX_DDR_DEVFREQ_DEBUGFS=y

#
# CLK CONTROLL
#
CONFIG_HI3XXX_CLK=y
CONFIG_COMMON_CLK_DEBUG=y
CONFIG_HISI_CLK_DEBUG=y
# CONFIG_HISI_CLK_ALWAYS_ON is not set
CONFIG_HI3XXX_CLK_MAILBOX_SUPPORT=y

CONFIG_DMA_SHARED_BUFFER=y
# DMA
CONFIG_DMADEVICES=y
CONFIG_HAS_DMA=y
CONFIG_DMA_ENGINE=y
CONFIG_DMA_VIRTUAL_CHANNELS=y
CONFIG_HISI_DMA=y
CONFIG_NEED_SG_DMA_LENGTH=n
# CONFIG_DMA_NO_CCI is not set
# CONFIG_HISI_DMA_PM_RUNTIME is not set
CONFIG_DMATEST=n

#
# I2C Hardware Bus support
#
CONFIG_I2C=y
CONFIG_I2C_BOARDINFO=y
CONFIG_I2C_COMPAT=y
CONFIG_I2C_HELPER_AUTO=y
# CONFIG_I2C_CHARDEV is not set

#
# I2C system bus drivers (mostly embedded / system-on-chip)
#
CONFIG_I2C_DESIGNWARE_CORE=y
CONFIG_I2C_DESIGNWARE_PLATFORM=y
CONFIG_I2C_DESIGNWARE_HI3XXX=y
CONFIG_HISI_I2C_DESIGNWARE=y

#
#Touchscreen Driver
CONFIG_INPUT=y
CONFIG_INPUT_TOUCHSCREEN=y
# CONFIG_TOUCHSCREEN_SYNAPTICS_I2C_RMI is not set
CONFIG_INPUT_EVDEV=y

#
#cyttsp4
#
CONFIG_TOUCHSCREEN_CYPRESS_CYTTSP4=y
CONFIG_TOUCHSCREEN_CYPRESS_CYTTSP4_DEVICETREE_SUPPORT=y
CONFIG_CYTTSP4_PLATFORM=y
CONFIG_CYPRESS_CYTTSP4_BUS=y
CONFIG_TOUCHSCREEN_CYPRESS_CYTTSP4_USE_FW_BIN_FILE=y
CONFIG_TOUCHSCREEN_CYPRESS_CYTTSP4_I2C=y
# CONFIG_TOUCHSCREEN_CYPRESS_CYTTSP4_SPI is not set
# CONFIG_TOUCHSCREEN_CYPRESS_CYTTSP4_MT_A is not set
#CONFIG_TOUCHSCREEN_CYPRESS_CYTTSP4_BUTTON is not set
CONFIG_TOUCHSCREEN_CYPRESS_CYTTSP4_MT_B=y
CONFIG_TOUCHSCREEN_CYPRESS_CYTTSP4_DEVICE_ACCESS=y
CONFIG_TOUCHSCREEN_CYPRESS_CYTTSP4_LOADER=y
# CONFIG_TOUCHSCREEN_CYPRESS_CYTTSP4_DEBUG is not set
# CONFIG_TOUCHSCREEN_CYPRESS_CYTTSP4_VDEBUG is not set
CONFIG_TOUCHSCREEN_CYPRESS_CYTTSP4_DEBUG_MODULE=y
# CONFIG_TOUCHSCREEN_CYPRESS_CYTTSP4_PLATFORM_FW_UPGRADE is not set
CONFIG_TOUCHSCREEN_CYPRESS_CYTTSP4_BINARY_FW_UPGRADE=y
# CONFIG_TOUCHSCREEN_CYPRESS_CYTTSP4_PLATFORM_TTCONFIG_UPGRADE is not set
CONFIG_TOUCHSCREEN_CYPRESS_CYTTSP4_MANUAL_TTCONFIG_UPGRADE=y
# CONFIG_TOUCHSCREEN_CYPRESS_CYTTSP4_PROXIMITY is not set
# CONFIG_TOUCHSCREEN_CYPRESS_CYTTSP4_DEVICE_ACCESS_API is not set
# CONFIG_TOUCHSCREEN_CYPRESS_CYTTSP4_TEST_DEVICE_ACCESS_API is not set
# CONFIG_EXTRA_FIRMWARE="cyttsp4_fw.bin"
# CONFIG_EXTRA_FIRMWARE_DIR="firmware"

#
# GPIO controllers
#
CONFIG_GPIO_PL061=y
CONFIG_ARCH_NR_GPIO=0
CONFIG_ARCH_HAVE_CUSTOM_GPIO_H=y
#CONFIG_ARCH_WANT_OPTIONAL_GPIOLIB is not set
#CONFIG_ARCH_REQUIRE_GPIOLIB is not set
CONFIG_GPIOLIB=y
CONFIG_OF_GPIO=y
# CONFIG_DEBUG_GPIO is not set
CONFIG_GPIO_SYSFS=y
# CONFIG_CONFIG_GPIO_PM_SUPPORT is not set
# mali gpu support
#
CONFIG_MALI_MIDGARD=y
CONFIG_MALI_DEVICE=y
CONFIG_MALI_MIDGARD_RT_PM=y
#
# mali gpu devfreq
#
CONFIG_DEVFREQ_GOV_MALI_ONDEMAND=y

CONFIG_SCHEDSTATS=y

#
# Pin controllers
#
CONFIG_PINMUX=y
CONFIG_PINCTRL=y
CONFIG_PINCONF=y
CONFIG_GENERIC_PINCONF=y
CONFIG_PINCTRL_SINGLE=y
# CONFIG_DEBUG_PINCTRL is not set

#
# Thermal driver
#
CONFIG_THERMAL=y
CONFIG_THERMAL_HWMON=y
CONFIG_THERMAL_OF=y
CONFIG_HI3XXX_THERMAL_TSENSOR=y
CONFIG_HI3XXX_THERMAL_PERIPHERAL=y
# CONFIG_THERMAL_EMULATION is not set

#
# Hardware spinlcok
#
CONFIG_HWSPINLOCK=y
CONFIG_HWSPINLOCK_HI3XXX=y
#
#HMP
#
CONFIG_SCHED_MC=y
CONFIG_DISABLE_CPU_SCHED_DOMAIN_BALANCE=y
CONFIG_SCHED_HMP=y
# CONFIG_SCHED_HMP_LITTLE_PACKING is not set
CONFIG_HMP_FAST_CPU_MASK=""
CONFIG_HMP_SLOW_CPU_MASK=""
CONFIG_HMP_VARIABLE_SCALE=y
CONFIG_HMP_FREQUENCY_INVARIANT_SCALE=y


#
# CPU Frequency scaling
#
CONFIG_PM_OPP=y
#cpufreq core
CONFIG_CPU_FREQ=y
CONFIG_CPU_FREQ_TABLE=y
CONFIG_CPU_FREQ_GOV_COMMON=y
CONFIG_CPU_FREQ_STAT=y
# CONFIG_CPU_FREQ_STAT_DETAILS is not set

#big.little
CONFIG_BIG_LITTLE=y
CONFIG_ARM_BIG_LITTLE_CPUFREQ=y
CONFIG_ARM_DT_BL_CPUFREQ=y
CONFIG_HISI_CPUFREQ=y
# CONFIG_INPUT_PULSE_SUPPORT is not set

#governor
CONFIG_CPU_FREQ_DEFAULT_GOV_PERFORMANCE=y
# CONFIG_CPU_FREQ_DEFAULT_GOV_USERSPACE is not set
# CONFIG_CPU_FREQ_DEFAULT_GOV_ONDEMAND is not set
# CONFIG_CPU_FREQ_DEFAULT_GOV_CONSERVATIVE is not set
# CONFIG_CPU_FREQ_DEFAULT_GOV_INTERACTIVE is not set
CONFIG_CPU_FREQ_GOV_PERFORMANCE=y
CONFIG_CPU_FREQ_GOV_POWERSAVE=y
CONFIG_CPU_FREQ_GOV_USERSPACE=y
CONFIG_CPU_FREQ_GOV_ONDEMAND=y
CONFIG_CPU_FREQ_GOV_INTERACTIVE=y
CONFIG_CPU_FREQ_GOV_CONSERVATIVE=y

#
#CPUIDLE support
#
CONFIG_GENERIC_CLOCKEVENTS_BROADCAST=y
CONFIG_CPU_IDLE=y
CONFIG_CPU_IDLE_MULTIPLE_DRIVERS=y
# CONFIG_CPU_IDLE_GOV_LADDER is not set
CONFIG_CPU_IDLE_GOV_MENU=y
CONFIG_OF_IDLE_STATES=y
CONFIG_ARM64_CPUIDLE=y

CONFIG_ARM_TIMER_SP804=y

#
# Misc devices
#
CONFIG_APANIC=y
CONFIG_APANIC_PLABEL="splash"
CONFIG_APANIC_MMC=y

#
# Hisi log support
#
CONFIG_HISI_LOG=y

#
# SYSTEM off and reset
#
CONFIG_HISI_REBOOT_TYPE=y
CONFIG_HI3XXX_POWER_OFF=y

#
# PMU
#
CONFIG_REGULATOR=y
CONFIG_HI3XXX_HI6421V300_PMIC=y
CONFIG_HI3XXX_REGULATOR_HI6421V300=y
CONFIG_HI3XXX_HI3630_CORE=y
CONFIG_HI3XXX_REGULATOR_KIRIN930=y
#CONFIG_HI6421_VIBRATOR is not set
#CONFIG_LEDS_HI6421 is not set
#CONFIG_KEYBOARD_HISI_GPIO_KEY is not set


CONFIG_RTC_CLASS=y
CONFIG_RTC_HCTOSYS=y
CONFIG_RTC_HCTOSYS_DEVICE="rtc0"
#
# RTC interfaces
#
CONFIG_RTC_INTF_SYSFS=y
CONFIG_RTC_INTF_PROC=y
CONFIG_RTC_INTF_DEV=y
#
# on-CPU RTC drivers
#
# CONFIG_RTC_DRV_PL030 is not set
CONFIG_RTC_DRV_PL031=y

#
# PMU RTC
#
# CONFIG_RTC_DRV_HI3635_PMU is not set
# CONFIG_RTC_DRV_HI6421V300 is not set

#
# USB
#
CONFIG_HW_GADGET=y
CONFIG_USB_SUPPORT=y
CONFIG_USB_COMMON=y
CONFIG_USB_ARCH_HAS_HCD=y
CONFIG_USB=y
CONFIG_USB_DEFAULT_PERSIST=y

CONFIG_USB_SUSB_HDRC=y
CONFIG_USB_SUSB_PCD=y
CONFIG_USB_SUSB_HCD=y
CONFIG_USB_DWC3=y
CONFIG_USB_DWC3_DUAL_ROLE=y
CONFIG_USB_GADGET=y
CONFIG_USB_GADGET_DEBUG=y
CONFIG_USB_GADGET_DEBUG_FILES=y
CONFIG_USB_GADGET_DEBUG_FS=y
CONFIG_USB_GADGET_VBUS_DRAW=2
CONFIG_USB_GADGET_STORAGE_NUM_BUFFERS=2
CONFIG_USB_LIBCOMPOSITE=y
CONFIG_USB_F_ACM=y
CONFIG_USB_U_SERIAL=y
CONFIG_USB_F_SERIAL=y
CONFIG_MODEM_SUPPORT=y
CONFIG_USB_G_ANDROID=y
CONFIG_USB_ANDROID_RNDIS_DWORD_ALIGNED=y

CONFIG_SOUND=y
CONFIG_SND=y
#CONFIG_SND_PCM_OSS is not set
CONFIG_HAVE_MEMBLOCK=y
CONFIG_ION_HI3XXX=y
CONFIG_HISI_IODOMAIN_API=y
CONFIG_ION=y
CONFIG_ION_HISI=y

CONFIG_IOMMU_API=y
CONFIG_IOMMU_SUPPORT=y
CONFIG_OF_IOMMU=y
CONFIG_HISI_IOMMU=y
CONFIG_HISI_IOMMU_TEST=y
CONFIG_HI3XXX_IOMMU=y

#mtd
CONFIG_MTD=y
CONFIG_BALONG_MTD=y
CONFIG_MTD_CMDLINE_PARTS=y
CONFIG_MTD_CHAR=y
CONFIG_HISI_NVE=y
CONFIG_MTD_BLKDEVS=y
CONFIG_MTD_BLOCK=y
CONFIG_MTD_BLOCK2MTD=y
CONFIG_MTD_OOPS=y
CONFIG_MTD_MAP_BANK_WIDTH_1=y
CONFIG_MTD_MAP_BANK_WIDTH_2=y
CONFIG_MTD_MAP_BANK_WIDTH_4=y
CONFIG_MTD_CFI_I1=y
CONFIG_MTD_CFI_I2=y

#
# Multimedia core support
#
CONFIG_MEDIA_SUPPORT=y
CONFIG_MEDIA_CAMERA_SUPPORT=y
CONFIG_MEDIA_CONTROLLER=y
CONFIG_VIDEO_DEV=y
CONFIG_VIDEO_V4L2_COMMON=y
# CONFIG_DVB_CORE is not set
CONFIG_VIDEO_MEDIA=y
#
# camera support
#
CONFIG_USE_CAMERA3_ARCH=y
#CONFIG_HUAWEI_CAMERA_USE_EXTISP=y

CONFIG_HI3XXX_EFUSE=y

#
# Logger extend configuration
#
CONFIG_LOGGER_EXTEND=y
CONFIG_LOG_SWITCH=y
CONFIG_LOG_EXCEPTION=y
CONFIG_LOG_JANK=y

#
# cmdline
#
CONFIG_HI3XXX_CMDLINE_PARSE=y

#
# watchdog support
#
CONFIG_WATCHDOG=y
CONFIG_ARM_SP805_WATCHDOG=y

#
#simcard hotplug
#
CONFIG_HI3XXX_SIM_HOTPLUG=y
CONFIG_HI3XXX_CMDLINE_PARSE=y
CONFIG_HISILICON_PLATFORM_DDRC=y
CONFIG_HI3XXX_DDRC=y
CONFIG_HISILICON_PLATFORM_NOC=y
CONFIG_HI3XXX_NOC=y
CONFIG_HI3XXX_NOC_ERR_PROBE=y

#
# HI3XXX hkadc support
#
CONFIG_HI3XXX_HKADC=y
#CONFIG_HI3XXX_HKADC_DEBUG is not set

#axierr
CONFIG_HISI_AXI=y

# enable device tree proc
CONFIG_PROC_DEVICETREE=y

#sensorhub
CONFIG_SENSORHUB_FEATURE_SUPPORT=y
CONFIG_INPUTHUB=y
CONFIG_IOM3_RECOVERY=y

CONFIG_HUAWEI_DSM=y

# trustedcore tzdriver
CONFIG_SECURE_EXTENSION=y
CONFIG_TZDRIVER=y

#
# rdr
#
CONFIG_HISI_RDR=y
CONFIG_HISI_RDR_TEST=y

CONFIG_SEATTLE=y
## power support
##
CONFIG_POWER_HUAWEI_S=y
CONFIG_BATTERY_HISI_COUL_S=y
CONFIG_BATTERY_HISI_HI6421V300_S=y
CONFIG_BQ_BCI_BATTERY_S=y
CONFIG_BQ2419X_CHARGER_S=y
CONFIG_BATTERY_COULOMB_TEST_INTERFACE_S=y
CONFIG_BATTERY_HISI_COUL_TEST_S=y

#nfc
#CONFIG_NFC_DEVICES=y
#CONFIG_PN547_NFC_64=y
```
